## cs35l56/samples/zephyr/sample_app/dts/bindings/haptics/cs35l56-base.yaml
```yaml
description: CS35L56 Audio Driver

compatible: "cirrus,cs35l56_alt_os"

include: ["i2c-device.yaml"]

properties:
  reset-gpios:
    required: true
    type: phandle-array
    description: Host GPIO pin mapped to CS35L56 reset pin.
```
