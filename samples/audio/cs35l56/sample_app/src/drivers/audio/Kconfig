## samples/audio/cs35l56/sample_app/src/drivers/audio/Kconfig
```kconfig
# Copyright 2024 Cirrus Logic, Inc.
#
# SPDX-License-Identifier: Apache-2.0

menuconfig AUDIO
	bool "Audio drivers"
	help
	  Enable audio driver configuration.

if AUDIO

module = AUDIO
module-str = audio
source "subsys/logging/Kconfig.template.log_config"

config AUDIO_INIT_PRIORITY
	int "Audio driver init priority"
	default 90
	help
	  Audio driver initialization priority.

rsource "Kconfig.cs35l56"

endif # AUDIO
```

## samples/audio/cs35l56/sample_app/src/drivers/audio/Kconfig.cs35l56
```kconfig
# Copyright 2024 Cirrus Logic, Inc.
# SPDX-License-Identifier: Apache-2.0

config AUDIO_CS35L56
	bool "CS35L56 Audio Driver"
	default y
	select I2C
	help
	  Enable I2C-based driver for the Cirrus CS35L56 Audio Driver.
```

## samples/haptics/cs40l50/src/drivers/haptics/Kconfig.cs40l50
```kconfig
# Copyright 2024 Cirrus Logic, Inc.
# SPDX-License-Identifier: Apache-2.0

config HAPTICS_CS40L50
	bool "CS40L50 Haptics Driver"
	default y
	select I2C
	help
	  Enable I2C-based driver for the Cirrus CS40L50 Haptics Driver.
```

## samples/haptics/cs40l5x/host_init_haptics/src/drivers/haptics/Kconfig.cs40l5x
```kconfig
# Copyright 2024 Cirrus Logic, Inc.
# SPDX-License-Identifier: Apache-2.0

config HAPTICS_CS40L5X_ALT_OS
	bool "CS40L5X Haptics Driver"
	default y
	select I2C
	help
	  Enable I2C-based driver for the Cirrus CS40L5X Haptics Driver.
```

## samples/haptics/cs40l5x/sample_app/src/drivers/haptics/Kconfig
```kconfig
# Copyright 2024 Cirrus Logic, Inc.
#
# SPDX-License-Identifier: Apache-2.0

menuconfig HAPTICS
	bool "Haptic feedback drivers"
	help
	  Enable haptics driver configuration.

if HAPTICS

module = HAPTICS
module-str = haptics
source "subsys/logging/Kconfig.template.log_config"

config HAPTICS_INIT_PRIORITY
	int "Haptic driver init priority"
	default 90
	help
	  Haptic driver initialization priority.

choice HAPTICS_CS40L5X_VARIANT
	prompt "CS40L5X Build Variant"
	default HAPTICS_CS40L51
	help
		Select the CS40L5X variant to build. These variants are mutually exclusive.

config HAPTICS_CS40L51
	bool "CS40L51 Build Variant"
	help
		Configure CS40l5X driver for L51 build variant

config HAPTICS_CS40L52
	bool "CS40L52 Build Variant"
	help
		Configure CS40l5X driver for L52 build variant

config HAPTICS_CS40L53
	bool "CS40L53 Build Variant"
	help
		Configure CS40l5X driver for L53 build variant

endchoice

rsource "Kconfig.cs40l5x"

endif # HAPTICS
```
