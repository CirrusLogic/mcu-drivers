## CMakeLists.txt
```
# SPDX-License-Identifier: Apache-2.0
set(DRIVER_BASE "../../../..")
cmake_minimum_required(VERSION 3.20.0)

find_package(Zephyr REQUIRED HINTS $ENV{ZEPHYR_BASE})
project(cs40l5x)

FILE(GLOB app_sources src/*.c ${DRIVER_BASE}/cs40l5x/*.c ${DRIVER_BASE}/common/fw_img.c)

# Only compile firmware data for the selected CS40L5x variant.
# Multiple firmware .c files define shared symbol names like
# cs40l5x_A2H_coeff_blocks and cs40l5x_SVC_coeff_blocks.
list(REMOVE_ITEM app_sources
	${CMAKE_CURRENT_SOURCE_DIR}/src/cs40l51_firmware.c
	${CMAKE_CURRENT_SOURCE_DIR}/src/cs40l52_firmware.c
	${CMAKE_CURRENT_SOURCE_DIR}/src/cs40l53_firmware.c)

if(CONFIG_HAPTICS_CS40L51)
	list(APPEND app_sources ${CMAKE_CURRENT_SOURCE_DIR}/src/cs40l51_firmware.c)
elseif(CONFIG_HAPTICS_CS40L52)
	list(APPEND app_sources ${CMAKE_CURRENT_SOURCE_DIR}/src/cs40l52_firmware.c)
elseif(CONFIG_HAPTICS_CS40L53)
	list(APPEND app_sources ${CMAKE_CURRENT_SOURCE_DIR}/src/cs40l53_firmware.c)
endif()

target_sources(app PRIVATE ${app_sources})

zephyr_library_add_dependencies(offsets_h)

zephyr_compile_definitions(CIRRUS_ZEPHYR_SAMPLE)

add_subdirectory(src)
```

## Kconfig
```
# Copyright (c) 2021 Nordic Semiconductor ASA
# SPDX-License-Identifier: Apache-2.0
#
# This Kconfig file is picked by the Zephyr build system because it is defined
# as the module Kconfig entry point (see zephyr/module.yml). You can browse
# module options by going to Zephyr -> Modules in Kconfig.

source "Kconfig"
rsource "src/drivers/haptics/Kconfig"
```

## prj.conf
```kconfig
CONFIG_GPIO=y
CONFIG_LOG=y
CONFIG_HAPTICS=y
CONFIG_HAPTICS_CS40L5X_ALT_OS=y
CONFIG_HEAP_MEM_POOL_SIZE=8192
# Uncomment to Enable Debugging
CONFIG_SHELL=y
CONFIG_I2C_SHELL=y

CONFIG_HAPTICS_CS40L51=y
# CONFIG_HAPTICS_CS40L52 is not set
# CONFIG_HAPTICS_CS40L53 is not set
```

## dts/bindings/haptics/cs40l5x-base.yaml
```yaml
description: CS40L5X Haptic Driver

compatible: "cirrus,cs40l5x_alt_os"

include: ["i2c-device.yaml"]

properties:
  reset-gpios:
    type: phandle-array
    required: true
    description: Host GPIO pin mapped to CS40L5X reset pin.
```

## src/main.c
```c
/*
 * Copyright (c) Cirrus Logic 2026 All Rights Reserved, http://www.cirrus.com/
 *
 * Licensed under the Apache License, Version 2.0 (the License); you may
 * not use this file except in compliance with the License.
 * You may obtain a copy of the License at
 *
 * www.apache.org/licenses/LICENSE-2.0
 *
 * Unless required by applicable law or agreed to in writing, software
 * distributed under the License is distributed on an AS IS BASIS, WITHOUT
 * WARRANTIES OR CONDITIONS OF ANY KIND, either express or implied.
 * See the License for the specific language governing permissions and
 * limitations under the License.
 *
 */

#include <errno.h>

#include <zephyr/device.h>
#include <zephyr/devicetree.h>
#include <zephyr/kernel.h>
#include <zephyr/logging/log.h>
#include <zephyr/drivers/haptics.h>
#include <zephyr/drivers/i2c.h>
// #include "drivers/haptics/cs40l5x.h"
#include <zephyr/drivers/uart.h>
#include <zephyr/sys/util.h>
#include <zephyr/shell/shell.h>
#include <sys/_stdint.h>
#include <ctype.h>

#define LOG_LEVEL 4

#include "cs40l5x_bsp.h"

LOG_MODULE_REGISTER(main);

const struct device *cs40l5x = DEVICE_DT_GET(DT_NODELABEL(haptic1));

#if CONFIG_SHELL
#define CS40L5X_HELP          SHELL_HELP("CS40L5X haptics commands", NULL)
#define CS40L5X_START_A2H     SHELL_HELP("Begin A2H streaming", NULL)
#define CS40L5X_STOP_A2H      SHELL_HELP("Stop A2H streaming", NULL)
#define CS40L5X_BASIC_TRIGGER SHELL_HELP("Perform a normal wavetable trigger", "<ROM/RAM> <index>")
#define CS40L5X_VIBECOMP_TRIGGER SHELL_HELP("Stop A2H streaming", "<ROM/RAM> <index> <speed>")

// Helper function to convert and validate shell input is int values in valid range
static int convert_int_input(const struct shell *sh, char *input, uint32_t *output, uint32_t min,
                 uint32_t max)
{
    char *endptr;
    if (!input) {
        return -1;
    }
    if ((input[0] == '0' && input[1] == 'x') || (input[0] == '0' && input[1] == 'X')) {
        for (int i = 2; input[i] != '\0'; i++) {
            if (!isxdigit(input[i])) {
                shell_error(sh, "Error: Invalid input parameter %s\n", input);
                return -1;
            }
        }

        *output = (uint32_t)strtol(input, &endptr, 16);
        if (*output < min || *output > max) {
            printf("Error: Invalid input %s, input must be number between %d and %d\n",
                   input, min, max);
            return -1;
        }
        return 0;
    } else {
        for (int i = 0; input[i] != '\0'; i++) {
            if (!isdigit(input[i])) {
                shell_error(sh, "Error: Invalid input parameter %s\n", input);
                return -1;
            }
        }

        *output = (uint32_t)strtol(input, &endptr, 0);
        if (*output < min || *output > max) {
            printf("Error: Invalid input %s, input must be number between %d and %d\n",
                   input, min, max);
            return -1;
        }
        return 0;
    }
}

static int cmd_start_A2H(const struct shell *sh, size_t argc, char **argv)
{
    uint32_t ret;
    printf("\nStarting ASP streaming...\n");
    ret = bsp_cs40l5x_start_i2s(cs40l5x);
    if (ret) {
        LOG_ERR("Problem starting A2H");
    }
    return ret;
}

static int cmd_stop_A2H(const struct shell *sh, size_t argc, char **argv)
{
    uint32_t ret;
    printf("\nStopping ASP streaming...\n");
    ret = bsp_cs40l5x_stop_i2s(cs40l5x);
    if (ret) {
        LOG_ERR("Problem stopping A2H");
    }
    return ret;
}

static int cmd_basic_trigger(const struct shell *sh, size_t argc, char **argv)
{
    uint32_t ret;
    struct cs40l5x_haptic_source_config hap_cfg;

    if (strcmp(argv[1], "ROM") == 0) {
        hap_cfg.bank = ROM_BANK;
    } else if (strcmp(argv[1], "RAM") == 0) {
        hap_cfg.bank = RAM_BANK;
    } else {
        printf("Invalid input for ROM/RAM bank\n");
        return -1;
    }
    ret = convert_int_input(sh, argv[2], &hap_cfg.index, 0, 30);
    ret = cs40l5x_set_haptic_cfg(cs40l5x, &hap_cfg);
    if (ret) {
        return ret;
    }

    ret = haptics_start_output(cs40l5x);
    if (ret) {
        return ret;
    }
    return ret;
}

static int cmd_vibecomp_trigger(const struct shell *sh, size_t argc, char **argv)
{
    uint32_t ret;
    struct cs40l5x_haptic_source_config hap_cfg;

    if (strcmp(argv[1], "ROM") == 0) {
        hap_cfg.bank = ROM_BANK;
    } else if (strcmp(argv[1], "RAM") == 0) {
        hap_cfg.bank = RAM_BANK;
    } else {
        printf("Invalid input for ROM/RAM bank\n");
        return -1;
    }

    ret = convert_int_input(sh, argv[2], &hap_cfg.index, 0, 30);
    ret = cs40l5x_set_haptic_cfg(cs40l5x, &hap_cfg);
    if (ret) {
        return ret;
    }

    uint32_t speed;
    ret = convert_int_input(sh, argv[3], &speed, 0, 255);
    ret = cs40l5x_set_vibecomp_speed(cs40l5x, speed);

    ret = haptics_start_output(cs40l5x);
    if (ret) {
        return ret;
    }
    return ret;
}

SHELL_STATIC_SUBCMD_SET_CREATE(
    cs40l5x_cmds, SHELL_CMD_ARG(start_A2H, NULL, CS40L5X_START_A2H, cmd_start_A2H, 1, 0),
    SHELL_CMD_ARG(stop_A2H, NULL, CS40L5X_STOP_A2H, cmd_stop_A2H, 1, 0),
    SHELL_CMD_ARG(basic_trigger, NULL, CS40L5X_BASIC_TRIGGER, cmd_basic_trigger, 3, 0),
    SHELL_CMD_ARG(vibecomp_trigger, NULL, CS40L5X_VIBECOMP_TRIGGER, cmd_vibecomp_trigger, 4, 0),
    SHELL_SUBCMD_SET_END);

SHELL_CMD_REGISTER(cs40l5x, &cs40l5x_cmds, "CS40L5X shell commands", NULL);
#endif /* CONFIG_SHELL */

#define SW0_NODE DT_ALIAS(sw0)
#if !DT_NODE_HAS_STATUS_OKAY(SW0_NODE)
#error "Unsupported board: sw0 devicetree alias is not defined"
#endif
static const struct gpio_dt_spec button = GPIO_DT_SPEC_GET_OR(SW0_NODE, gpios, {0});

int main(void)
{
    int ret;

    if (!gpio_is_ready_dt(&button)) {
        LOG_ERR("Error: button device %s is not ready", button.port->name);
        return 0;
    }

    ret = gpio_pin_configure_dt(&button, GPIO_INPUT);
    if (ret != 0) {
        LOG_ERR("Error %d: failed to configure %s pin %d", ret, button.port->name,
               button.pin);
        return 0;
    }
    char in_char;
    const struct device *uart = DEVICE_DT_GET(DT_NODELABEL(usart2));
    struct cs40l5x_haptic_source_config hap_cfg = {
        .index = CS40L5X_HAPTIC_ROM_CLICK_1_VCM,
        .bank = ROM_BANK,
    };
    cs40l5x_set_haptic_cfg(cs40l5x, &hap_cfg);

    if (!cs40l5x) {
        LOG_ERR("CS40L5X device not found");
        return -ENODEV;
    } else if (!device_is_ready(cs40l5x)) {
        LOG_ERR("CS40L5X device %s is not ready", cs40l5x->name);
        return -EIO;
    } else {
        LOG_INF("Found CS40L5X device %s", cs40l5x->name);
    }

    while (1) {

        ret = uart_poll_in(uart, &in_char);

        if (ret == 0) {
            ret = haptics_start_output(cs40l5x);
            if (ret < 0) {
                LOG_ERR("Failed to start output: %d", ret);
                return ret;
            }
        }
        k_msleep(1);
    }

    return 0;
}
```

## src/cs40l5x_bsp.c
```c
/*
 * Copyright (c) Cirrus Logic 2026 All Rights Reserved, http://www.cirrus.com/
 *
 * Licensed under the Apache License, Version 2.0 (the License); you may
 * not use this file except in compliance with the License.
 * You may obtain a copy of the License at
 *
 * www.apache.org/licenses/LICENSE-2.0
 *
 * Unless required by applicable law or agreed to in writing, software
 * distributed under the License is distributed on an AS IS BASIS, WITHOUT
 * WARRANTIES OR CONDITIONS OF ANY KIND, either express or implied.
 * See the License for the specific language governing permissions and
 * limitations under the License.
 *
 */

#include "cs40l5x_bsp.h"
#include "cs40l5x.h"
#include <zephyr/kernel.h>
#include <zephyr/logging/log.h>
#include <zephyr/drivers/i2c.h>

LOG_MODULE_REGISTER(cirrus_cs40l5x);

struct cs40l5x_config {
    struct i2c_dt_spec i2c;
    struct gpio_dt_spec reset_gpio;
    void (*irq_cfg_func)(void);
    void (*irq_enable_func)(void);
    void (*irq_disable_func)(void);
};

int cs40l5x_i2c_write_reg_dt(const struct i2c_dt_spec *spec, const uint32_t reg_addr,
                 const uint32_t value)
{
    uint8_t addr_buf[4], data_buf[4], msg_buf[8];
    int i, j = 4;

    sys_put_be32(reg_addr, addr_buf);
    sys_put_be32(value, data_buf);

    for (i = 0; i < ARRAY_SIZE(addr_buf); i++) {
        msg_buf[i] = addr_buf[i];
        msg_buf[j] = data_buf[i];
        j++;
    }

    return i2c_write_dt(spec, msg_buf, sizeof(msg_buf));
}

int cs40l5x_i2c_read_reg_dt(const struct i2c_dt_spec *spec, const uint32_t reg_addr,
                uint32_t *value)
{
    uint8_t write_buf[4], read_buf[4];
    int ret;

    sys_put_be32(reg_addr, write_buf);

    ret = i2c_write_read_dt(spec, write_buf, sizeof(write_buf), read_buf, sizeof(read_buf));
    if (ret < 0) {
        LOG_INF("cs40l5x_i2c_read_reg_dt error\n");
        return ret;
    }

    *value = sys_get_be32(read_buf);

    return 0;
}

int cs40l5x_update_reg_dt(const struct i2c_dt_spec *spec, const uint32_t reg_addr,
              const uint32_t mask, const uint32_t value)
{
    uint32_t old_value, new_value;
    int ret;

    ret = cs40l5x_i2c_read_reg_dt(spec, reg_addr, &old_value);
    if (ret < 0) {
        return ret;
    }

    new_value = (old_value & ~mask) | (value & mask);
    if (new_value == old_value) {
        return 0;
    }

    return cs40l5x_i2c_write_reg_dt(spec, reg_addr, new_value);
}

/* write addr/word pairs */
int cs40l5x_write_array_dt(const struct i2c_dt_spec *spec, const uint32_t *array, uint32_t words)
{
    int i, ret;

    for (i = 0; i < words; i += 2) {
        ret = cs40l5x_i2c_write_reg_dt(spec, array[i], array[i + 1]);
        if (ret < 0) {
            return ret;
        }
    }
    return 0;
}

/**
 * Reads a register for a specific value for a specified amount of tries while waiting between
 * reads.
 *
 */
int cs40l5x_poll_reg_dt(const struct i2c_dt_spec *spec, const uint32_t reg_addr, uint32_t value,
            uint32_t tries, uint32_t delay)
{
    uint32_t tmp;
    int i, ret;

    for (i = 0; i < tries; i++) {
        ret = cs40l5x_i2c_read_reg_dt(spec, reg_addr, &tmp);
        if (ret < 0) {
            return ret;
        }

        if (tmp == value) {
            return 0;
        }

        k_msleep(delay);
    }
    return 0;
}

int cs40l5x_write_acked_reg_dt(const struct i2c_dt_spec *spec, const uint32_t reg_addr,
                   uint32_t val, uint32_t acked_val, uint8_t tries, uint32_t delay)
{
    int i, ret;

    ret = cs40l5x_i2c_write_reg_dt(spec, reg_addr, val);
    if (ret < 0) {
        return ret;
    }

    for (i = 0; i < tries; i++) {
        uint32_t temp_reg_val;

        k_msleep(delay);

        cs40l5x_i2c_read_reg_dt(spec, reg_addr, &temp_reg_val);

        if (temp_reg_val == acked_val) {
            return 0;
        }
    }

    return -1;
}

int cs40l5x_i2c_write_bulk_bus(const struct i2c_dt_spec *spec, const uint32_t reg_addr,
                   const uint8_t *buf, unsigned int num_bytes, uint16_t bus_addr)
{
    uint8_t addr_buf[4], *msg_buf;
    int i = 4, ret = 0;

    LOG_INF("cs40l5x_i2c_write_bulk_bus: reg=%x size=%d\n", reg_addr, num_bytes);

    msg_buf = k_malloc(num_bytes + 4);
    if (!msg_buf) {
        return -ENOMEM;
    }

    sys_put_be32(reg_addr, addr_buf);

    for (i = 0; i < ARRAY_SIZE(addr_buf); i++) {
        msg_buf[i] = addr_buf[i];
    }

    bytecpy(msg_buf + 4, buf, num_bytes);

    ret = i2c_write(spec->bus, msg_buf, 4 + num_bytes, bus_addr);

    k_free(msg_buf);
    return ret;
}

int cs40l5x_i2c_write_bus(const struct i2c_dt_spec *spec, const uint32_t reg_addr, uint32_t val,
              uint16_t bus_addr)
{
    uint8_t addr_buf[4], data_buf[4], *msg_buf;
    int ret = 0;

    LOG_INF("cs40l5x_i2c_write_bus: reg=%x\n", reg_addr);

    msg_buf = k_malloc(8);
    if (!msg_buf) {
        return -ENOMEM;
    }

    sys_put_be32(reg_addr, addr_buf);
    sys_put_be32(val, data_buf);

    bytecpy(msg_buf, addr_buf, 4);
    bytecpy(msg_buf + 4, data_buf, 4);

    ret = i2c_write(spec->bus, msg_buf, 8, bus_addr);

    k_free(msg_buf);
    return ret;
}

int cs40l5x_i2c_write_bulk_dt(const struct i2c_dt_spec *spec, const uint32_t reg_addr,
                  const uint8_t *buf, unsigned int num_bytes)
{
    uint8_t addr_buf[4], *msg_buf;
    int i = 4, ret = 0;

    LOG_INF("cs40l5x_i2c_write_bulk_dt: reg=%x size=%d\n", reg_addr, num_bytes);

    msg_buf = k_malloc(num_bytes + 4);
    if (!msg_buf) {
        return -ENOMEM;
    }

    sys_put_be32(reg_addr, addr_buf);

    for (i = 0; i < ARRAY_SIZE(addr_buf); i++) {
        msg_buf[i] = addr_buf[i];
    }

    bytecpy(msg_buf + 4, buf, num_bytes);

    ret = i2c_write_dt(spec, msg_buf, sizeof(msg_buf) + num_bytes);

    k_free(msg_buf);
    return ret;
}

int cs40l5x_set_haptic_cfg(const struct device *dev, struct cs40l5x_haptic_source_config *hap_cfg)
{
    struct cs40l5x_bsp *data = dev->data;
    data->hap_cfg = *hap_cfg;
    return 0;
}

static int cs40l5x_write_fw_blocks(struct i2c_dt_spec *i2c, halo_boot_block_t *blocks,
                   int num_blocks)
{
    int i, ret;
    halo_boot_block_t block;
    uint32_t bytes, address;
    uint8_t *buffer;

    for (i = 0; i < num_blocks; i++) {
        block = blocks[i];
        bytes = block.block_size;
        address = block.address;
        buffer = (uint8_t *)block.bytes;
        ret = cs40l5x_i2c_write_bulk_dt(i2c, address, buffer, bytes);
        if (ret != 0) {
            return ret;
        }
        k_msleep(5);
    }

    return 0;
}

// static int cs40l5x_gpi_get_level(cs40l5x_t *drv, unsigned int gpio)
// {
//     uint32_t gpio_status;
//     struct i2c_dt_spec *i2c = drv->config.bsp_config.i2c;

//     if (gpio > 13)
//         return -1;

//     regmap_read(i2c, CS40L5X_GPIO_STATUS1, &gpio_status);

//     return ((gpio_status & (1 << (gpio - 1))) != 0);
// }

/* NOTE: Example tunings and wavetable are not designed for general-purpose applications and should
 * be used for verification purposes only. Please contact your Cirrus Logic representative for
 * application specific waveforms and tunings
 */
static int cs40l5x_firmware_load(cs40l5x_t *drv)
{
    int num_blocks, ret;
    halo_boot_block_t *blocks;
    struct i2c_dt_spec *i2c = drv->config.bsp_config.i2c;

    num_blocks = cs40l5x_total_fw_blocks;
    blocks = (halo_boot_block_t *)cs40l5x_fw_blocks;
    ret = cs40l5x_write_fw_blocks(i2c, blocks, num_blocks);
    if (ret != 0) {
        return ret;
    }

    num_blocks = cs40l5x_total_coeff_blocks_0;
    blocks = (halo_boot_block_t *)cs40l5x_coeff_0_blocks;
    ret = cs40l5x_write_fw_blocks(i2c, blocks, num_blocks);
    if (ret != 0) {
        return ret;
    }

    num_blocks = cs40l5x_total_coeff_blocks_1;
    blocks = (halo_boot_block_t *)cs40l5x_coeff_1_blocks;
    ret = cs40l5x_write_fw_blocks(i2c, blocks, num_blocks);
    if (ret != 0) {
        return ret;
    }

    LOG_INF("Loaded A2H tuning");

    return 0;
}

static int cs40l5x_clear_gpio_triggers(cs40l5x_t *drv)
{
    int i;
    struct i2c_dt_spec *i2c = drv->config.bsp_config.i2c;

    for (i = 0; i < 16; i++) {
        regmap_write(i2c, CS40L5X_GPIO_HANDLERS_BASE + i * 4, 0x1FF);
    }

    return 0;
}

static int cs40l5x_setup_gpi(cs40l5x_t *drv, unsigned int gpio)
{
    struct i2c_dt_spec *i2c = drv->config.bsp_config.i2c;

    if (gpio > 13) {
        return -1;
    }

    regmap_write(i2c, CS40L5X_GPIO_CTRL1 + (4 * (gpio - 1)),
             CS40L5X_GPIO_CTRL_DIR_BITMASK | CS40L5X_GPIO_CTRL_FN_INPUT_OUTPUT);
    return 0;
}

static uint32_t cs40l5x_set_timer(uint32_t duration_ms, bsp_callback_t cb, void *cb_arg)
{
    k_msleep(duration_ms);
    return 0;
}

static uint32_t cs40l5x_register_gpio_cb(const struct gpio_dt_spec *gpio_id, bsp_callback_t cb,
                     void *cb_arg)
{
    // TODO
    return 0;
}

static uint32_t cs40l5x_set_gpio(const struct gpio_dt_spec *gpio_id, uint8_t gpio_state)
{
    // TODO
    return 0;
}

bsp_driver_if_t cs40l5x_bsp_driver_if = {.set_timer = cs40l5x_set_timer,
                     .register_gpio_cb = cs40l5x_register_gpio_cb,
                     .set_gpio = cs40l5x_set_gpio};

bsp_driver_if_t *bsp_driver_if_g = &cs40l5x_bsp_driver_if;

/* ===================================================================================== */

static int cs40l5x_init(const struct device *dev)
{
    struct cs40l5x_config *config = (struct cs40l5x_config *)dev->config;
    struct cs40l5x_bsp *data = dev->data;
    cs40l5x_t *drv = &data->priv;
    uint32_t val;
    int ret;
    LOG_INF("cs40l5x_init\n");

    drv->config.bsp_config.i2c = &config->i2c;
    drv->config.syscfg_regs = cs40l5x_syscfg_regs;
    drv->config.syscfg_regs_total = CS40L5X_SYSCFG_REGS_TOTAL;
    drv->config.is_ext_bst = true;

    static const struct gpio_dt_spec reset =
        GPIO_DT_SPEC_GET(DT_NODELABEL(haptic1), reset_gpios);

    if (!gpio_is_ready_dt(&reset)) {
        LOG_INF("cs40l5x reset pin GPIO port is not ready.\n");
        return 0;
    }

    ret = gpio_pin_configure_dt(&reset, GPIO_OUTPUT_INACTIVE);
    if (ret != 0) {
        LOG_INF("cs40l5x configuring reset pin failed: %d\n", ret);
        return 0;
    }

    drv->config.bsp_config.reset_gpio_id = &reset;
    // Activate RESET for at least T_RLPW (1ms)
    gpio_pin_set_dt(&reset, BSP_GPIO_ACTIVE);
    k_msleep(2);
    // Wait for Lochnagar to boot
    gpio_pin_set_dt(&reset, BSP_GPIO_INACTIVE);
    k_msleep(2500);

    if (!i2c_is_ready_dt(&config->i2c)) {
        LOG_INF("cs40l5x no I2C\n");
        return -ENODEV;
    }

    ret = cs40l5x_reset(drv);
    if (ret < 0) {
        return ret;
    }

    k_msleep(1000);

    regmap_read(&config->i2c, FIRMWARE_CS40L5X_HALO_STATE, &val);
    LOG_INF("cs40l5x_init: HALO_STATE = %x\n", val);

    LOG_INF("cs40l5x_calibrate\n");
    ret = cs40l5x_calibrate(drv);
    if (ret < 0) {
        LOG_INF("cs40l5x_calibrate error\n");
        return ret;
    }

    ret = cs40l5x_boot(drv, NULL);
    if (ret < 0) {
        LOG_INF("cs40l5x_boot error\n");
        return ret;
    }

    cs40l5x_setup_gpi(drv, 1);

    LOG_INF("cs40l5x_firmware_load\n");
    ret = cs40l5x_firmware_load(drv);
    if (ret < 0) {
        LOG_INF("cs40l5x_firmware_load error\n");
        return ret;
    }

    ret = regmap_write(&config->i2c, CS40L5X_DSP1_CCM_CORE_CONTROL, 0x00000281);
    if (ret < 0) {
        LOG_INF("cs40l5x_boot error\n");
        return ret;
    }

    cs40l5x_clear_gpio_triggers(drv);

    LOG_INF("cs40l5x_init: Enable ASP");
    ret = cs40l5x_set_asp_enable(drv, true,
                     3072000); // Enable PPL with 3.072 MHz refclk frequency

    k_msleep(1000);

    /* to-do */
    regmap_read(&config->i2c, FIRMWARE_CS40L5X_HALO_STATE, &val);
    LOG_INF("cs40l5x_init: HALO_STATE = %x\n", val);

    //    config->irq_cfg_func();
    //    config->irq_enable_func();

    return 0;
}

static int haptics_cs40l5x_stop_output(const struct device *dev)
{
    return 0;
}

static int haptics_cs40l5x_start_output(const struct device *dev)
{
    struct cs40l5x_bsp *data = (struct cs40l5x_bsp *)dev->data;
    LOG_INF("haptics_cs40l5x_start_output, bank=%x, index=%x\n", data->hap_cfg.bank,
        data->hap_cfg.index);

    cs40l5x_trigger(&data->priv, data->hap_cfg.index, data->hap_cfg.bank);

    return 0;
}

int bsp_cs40l5x_start_i2s(const struct device *dev)
{
    uint32_t ret;
    struct cs40l5x_bsp *data = dev->data;
    cs40l5x_t *drv = &data->priv;
    ret = cs40l5x_set_asp_enable(drv, true, 3072000); // Enable PPL with 3.072 MHz refclk frequency
    return ret;
}
int bsp_cs40l5x_stop_i2s(const struct device *dev)
{
    uint32_t ret;
    struct cs40l5x_bsp *data = dev->data;
    cs40l5x_t *drv = &data->priv;
    ret = cs40l5x_set_asp_enable(drv, false, 3072000); // Enable PPL with 3.072 MHz refclk frequency
    return ret;
}

int cs40l5x_set_vibecomp_speed(const struct device *dev, uint32_t speed)
{
#ifdef CONFIG_HAPTICS_CS40L51
    struct cs40l5x_config *config = (struct cs40l5x_config *)dev->config;
    if(dev == NULL)
    {
        return BSP_STATUS_FAIL;
    }

    uint32_t ret = regmap_write(&config->i2c, VIBECOMP_CURR_SPEED, speed);
    return ret;
#endif

#ifdef CONFIG_HAPTICS_CS40L52
    LOG_ERR("VIBECOMP not support on CS40L52 FW!");
    return BSP_STATUS_FAIL;
#endif

#ifdef CONFIG_HAPTICS_CS40L53
        LOG_ERR("VIBECOMP not support on CS40L53 FW!");
        return BSP_STATUS_FAIL;
#endif
}

static const struct haptics_driver_api cs40l5x_driver_api = {
    .start_output = &haptics_cs40l5x_start_output,
    .stop_output = &haptics_cs40l5x_stop_output,
};

// static void cs40l5x_isr(void *arg)
// {
// }

#define CS40L5X_INIT(inst)                                                                         \
                                                                                                   \
    static const struct cs40l5x_config cs40l5x_config_##inst = {                               \
        .i2c = I2C_DT_SPEC_INST_GET(inst),                                                 \
    };                                                                                         \
                                                                                                   \
    static struct cs40l5x_bsp cs40l5x_bsp_data_##inst = {                                      \
                                                                                                   \
    };                                                                                         \
                                                                                                   \
    PM_DEVICE_DT_INST_DEFINE(inst, cs40l5x_pm_action);                                         \
                                                                                                   \
    DEVICE_DT_INST_DEFINE(inst, &cs40l5x_init, NULL, &cs40l5x_bsp_data_##inst,                 \
                  &cs40l5x_config_##inst, POST_KERNEL, CONFIG_HAPTICS_INIT_PRIORITY,   \
                  &cs40l5x_driver_api);

DT_INST_FOREACH_STATUS_OKAY(CS40L5X_INIT)

/* ===================================================================================== */
```

## src/cs40l5x_bsp.h
```c
/*
 * Copyright (c) Cirrus Logic 2026 All Rights Reserved, http://www.cirrus.com/
 *
 * Licensed under the Apache License, Version 2.0 (the License); you may
 * not use this file except in compliance with the License.
 * You may obtain a copy of the License at
 *
 * www.apache.org/licenses/LICENSE-2.0
 *
 * Unless required by applicable law or agreed to in writing, software
 * distributed under the License is distributed on an AS IS BASIS, WITHOUT
 * WARRANTIES OR CONDITIONS OF ANY KIND, either express or implied.
 * See the License for the specific language governing permissions and
 * limitations under the License.
 *
 */

#ifndef CS40L5X_BSP_H
#define CS40L5X_BSP_H

#define DT_DRV_COMPAT cirrus_cs40l5x_alt_os

#include "cs40l5x.h"
#include <stdbool.h>

#include <zephyr/sys/byteorder.h>
#include <zephyr/device.h>
#include <zephyr/pm/device.h>
#include <zephyr/pm/device_runtime.h>
#include <zephyr/devicetree.h>
#include <zephyr/drivers/gpio.h>
#include <zephyr/drivers/haptics.h>
#include <zephyr/irq.h>
#include <zephyr/kernel.h>
#include <zephyr/logging/log.h>
#include <zephyr/sys/util.h>

#ifdef CONFIG_HAPTICS_CS40L51
#include "cs40l51_firmware.h"
#define cs40l5x_total_fw_blocks cs40l51_total_fw_blocks
#define cs40l5x_fw_blocks       cs40l51_fw_blocks

#define cs40l5x_total_coeff_blocks_0 cs40l51_total_coeff_blocks_0
#define cs40l5x_total_coeff_blocks_1 cs40l51_total_coeff_blocks_1
#define cs40l5x_coeff_0_blocks       cs40l51_coeff_0_blocks
#define cs40l5x_coeff_1_blocks       cs40l51_coeff_1_blocks
#endif

#ifdef CONFIG_HAPTICS_CS40L52
#include "cs40l52_firmware.h"
#define cs40l5x_total_fw_blocks cs40l52_total_fw_blocks
#define cs40l5x_fw_blocks       cs40l52_fw_blocks

#define cs40l5x_total_coeff_blocks_0 cs40l52_total_coeff_blocks_0
#define cs40l5x_total_coeff_blocks_1 cs40l52_total_coeff_blocks_1
#define cs40l5x_coeff_0_blocks       cs40l52_coeff_0_blocks
#define cs40l5x_coeff_1_blocks       cs40l52_coeff_1_blocks
#endif

#ifdef CONFIG_HAPTICS_CS40L53
#include "cs40l53_firmware.h"
#define cs40l5x_total_fw_blocks cs40l53_total_fw_blocks
#define cs40l5x_fw_blocks       cs40l53_fw_blocks

#define cs40l5x_total_coeff_blocks_0 cs40l53_total_coeff_blocks_0
#define cs40l5x_total_coeff_blocks_1 cs40l53_total_coeff_blocks_1
#define cs40l5x_coeff_0_blocks       cs40l53_coeff_0_blocks
#define cs40l5x_coeff_1_blocks       cs40l53_coeff_1_blocks
#endif

#define regmap_cp_config_t     struct i2c_dt_spec
#define REGMAP_GET_CP(x)       x->config.bsp_config.i2c
#define regmap_read            cs40l5x_i2c_read_reg_dt
#define regmap_write           cs40l5x_i2c_write_reg_dt
#define regmap_update_reg      cs40l5x_update_reg_dt
#define regmap_write_array     cs40l5x_write_array_dt
#define regmap_poll_reg        cs40l5x_poll_reg_dt
#define regmap_write_acked_reg cs40l5x_write_acked_reg_dt
#define regmap_write_blocks    cs40l5x_i2c_write_bulk_dt

/***********************************************************************************************************************
 * LITERALS & CONSTANTS
 **********************************************************************************************************************/

/**
 * @defgroup BSP_STATUS_
 * @brief Return values for all public and most private API calls
 *
 * @{
 */
#define BSP_STATUS_OK   (0)
#define BSP_STATUS_FAIL (1)
/** @} */

/**
 * @defgroup BSP_TIMER_DURATION_
 * @brief Values used for calls to BSP timer APIs
 *
 * @see bsp_driver_if_t.set_timer
 *
 * @{
 */
#define BSP_TIMER_DURATION_1MS  (1)
#define BSP_TIMER_DURATION_2MS  (2)
#define BSP_TIMER_DURATION_5MS  (5)
#define BSP_TIMER_DURATION_10MS (10)
#define BSP_TIMER_DURATION_2S   (2000)
/** @} */

/**
 * Value to indicate driving a GPIO low
 *
 * @see bsp_driver_if_t.set_gpio
 *
 */
#define BSP_GPIO_LOW (0)
#define BSP_GPIO_INACTIVE (0)

/**
 * Value to indicate driving a GPIO high
 *
 * @see bsp_driver_if_t.set_gpio
 *
 */
#define BSP_GPIO_HIGH (1)
#define BSP_GPIO_ACTIVE (1)

/**
 * Value to indicate enabling or disabling a supply
 *
 * @see bsp_driver_if_t.set_supply
 *
 */
#define BSP_SUPPLY_DISABLE (0)
#define BSP_SUPPLY_ENABLE  (1)

/**
 * Example ROM wavetable waveform index
 */
// #define CS40L5X_HAPTIC_ROM_CLICK_1_VCM  (0x0A)

/***********************************************************************************************************************
 * MACROS
 **********************************************************************************************************************/

/**
 * Macro to extract byte from multi-byte word
 *
 * @param [in] A                multi-byte word
 * @param [in] B                zero-indexed byte position
 *
 * @return                      byte at position B in word A
 */
#define GET_BYTE_FROM_WORD(A, B) ((A >> (B * 8)) & 0xFF)

/**
 * Macro to insert byte into multi-byte word
 *
 * @param [in, out] A           multi-byte word
 * @param [in] B                byte value
 * @param [in] C                zero-indexed byte position
 *
 * @return none
 */
#define ADD_BYTE_TO_WORD(A, B, C)                                                                  \
    {                                                                                          \
        A &= (0xFFFFFF00 << (C * 8));                                                      \
        A |= ((B & 0xFF) << (C * 8));                                                      \
    }

/***********************************************************************************************************************
 * ENUMS, STRUCTS, UNIONS, TYPEDEFS
 **********************************************************************************************************************/

/**
 * Callback type for BSP-to-Driver callbacks
 *
 * @param [in] status           Result of BSP call
 * @param [in] arg              Argument registered when BSP call was issued
 *
 * @return none
 *
 * @see BSP_STATUS_
 *
 */
typedef void (*bsp_callback_t)(uint32_t status, void *arg);

/**
 * BSP-to-Driver public API
 *
 * All API calls return a status @see CS40L5X_STATUS_
 *
 */
typedef struct {
    /**
     * Set GPIO to LOW/HIGH
     *
     * @param [in] gpio_id      ID for GPIO to change - can be defined in implementation header
     * @param [in] gpio_state   LOW or HIGH
     *
     * @return
     * - BSP_STATUS_FAIL        if gpio_id is invalid, or call to MCU HAL fails
     * - BSP_STATUS_OK          otherwise
     *
     * @see BSP_GPIO_LOW BSP_GPIO_HIGH
     *
     */
    uint32_t (*set_gpio)(const struct gpio_dt_spec *gpio_id, uint8_t gpio_state);

    /**
     * Enable or disable a supply
     *
     * @param [in] supply_id      ID for supply to change - can be defined in implementation
     * header
     * @param [in] supply_state   Enable or Disable
     *
     * @return
     * - BSP_STATUS_FAIL        if gpio_id is invalid, or call to MCU HAL fails
     * - BSP_STATUS_OK          otherwise
     *
     * @note this function shouldn't return until the supply has finished rising or falling
     *
     * @see BSP_SUPPLY_ENABLE BSP_SUPPLY_DISABLE
     *
     */
    uint32_t (*set_supply)(uint32_t supply_id, uint8_t supply_state);

    /**
     * Register GPIO Callback
     *
     * Register a callback for when a GPIO changes state.
     *
     * @param [in] gpio_id      ID for GPIO to change - can be defined in implementation header
     * @param [in] cb           pointer to callback function
     * @param [in] cb_arg       pointer to argument to use when calling callback
     *
     * @return
     * - BSP_STATUS_FAIL        if gpio_id is invalid, if any pointers are NULL
     * - BSP_STATUS_OK          otherwise
     *
     */
    uint32_t (*register_gpio_cb)(const struct gpio_dt_spec *gpio_id, bsp_callback_t cb,
                     void *cb_arg);

    /**
     * Set a timer to expire
     *
     * @param [in] duration_ms  Duration of timer in milliseconds
     * @param [in] cb           pointer to callback function
     * @param [in] cb_arg       pointer to argument to use when calling callback
     *
     * @return
     * - BSP_STATUS_FAIL        if duration_ms is invalid, if any pointers are NULL
     * - BSP_STATUS_OK          otherwise
     *
     */
    uint32_t (*set_timer)(uint32_t duration_ms, bsp_callback_t cb, void *cb_arg);

    /**
     * Reset I2C Port used for a specific device
     *
     * Abort the current I2C transaction and reset the I2C peripheral.  This is required for
     * quickly handling of CS40L5X IRQ events.
     *
     * @param [in] bsp_dev_id       ID of the I2C device corresponding to the I2C peripheral to
     * reset
     * @param [out] was_i2c_busy    flag to indicate whether an I2C transaction was in progress
     * when reset
     *
     * @return
     * - BSP_STATUS_FAIL        if bsp_dev_id is invalid
     * - BSP_STATUS_OK          otherwise
     *
     */
    uint32_t (*i2c_reset)(uint32_t bsp_dev_id, bool *was_i2c_busy);

    /**
     * Perform an I2C Write-Repeated Start-Read transaction
     *
     * This is the common way to read data from an I2C device with a register file, since the
     * address of the register to read must first be written to the device before reading any
     * contents.
     *
     * Perform transaction in the order:
     * 1. I2C Start
     * 2. I2C write of \b write_length bytes from \b write_buffer
     * 3. I2C Repeated Start
     * 4. I2C read of \b read_length bytes into \b read_buffer
     * 5. I2C Stop
     *
     * BSP will decode \b bsp_dev_id to the correct I2C bus and I2C address.
     *
     * @param [in] bsp_dev_id       ID of the I2C device corresponding to the I2C peripheral to
     * reset
     * @param [in] write_buffer     pointer to array of bytes to write
     * @param [in] write_length     total number of bytes in \b write_buffer
     * @param [in] read_buffer      pointer to array of bytes to load with I2C bytes read
     * @param [in] read_length      total number of bytes to read into \b read_buffer
     * @param [in] cb               pointer to callback function
     * @param [in] cb_arg           pointer to argument to use when calling callback
     *
     * @return
     * - BSP_STATUS_FAIL            if bsp_dev_id is invalid, if any portion of I2C transaction
     * failed
     * - BSP_STATUS_OK              otherwise
     *
     */
    uint32_t (*i2c_read_repeated_start)(uint32_t bsp_dev_id, uint8_t *write_buffer,
                        uint32_t write_length, uint8_t *read_buffer,
                        uint32_t read_length, bsp_callback_t cb, void *cb_arg);

    /**
     * Perform I2C Write
     *
     * BSP will decode \b bsp_dev_id to the correct I2C bus and I2C address.
     *
     * @param [in] bsp_dev_id       ID of the I2C device corresponding to the I2C peripheral to
     * reset
     * @param [in] write_buffer     pointer to array of bytes to write
     * @param [in] write_length     total number of bytes in \b write_buffer
     * @param [in] cb               pointer to callback function
     * @param [in] cb_arg           pointer to argument to use when calling callback
     *
     * @return
     * - BSP_STATUS_FAIL            if bsp_dev_id is invalid, if any portion of I2C transaction
     * failed
     * - BSP_STATUS_OK              otherwise
     *
     */
    uint32_t (*i2c_write)(uint32_t bsp_dev_id, uint8_t *write_buffer, uint32_t write_length,
                  bsp_callback_t cb, void *cb_arg);

    /**
     * Perform a Double-Buffered ("db") I2C Write
     *
     * This will first write the contents of \b write_buffer_0 to the I2C device, and then write
     * the contents of
     * \b write_buffer_1.
     *
     * @param [in] bsp_dev_id       ID of the I2C device corresponding to the I2C peripheral to
     * reset
     * @param [in] write_buffer_0   pointer to array of first batch of bytes to write
     * @param [in] write_length_0   total number of bytes in \b write_buffer_0
     * @param [in] write_buffer_1   pointer to array of second batch of bytes to write
     * @param [in] write_length_1   total number of bytes in \b write_buffer_1
     * @param [in] cb               pointer to callback function
     * @param [in] cb_arg           pointer to argument to use when calling callback
     *
     * @return
     * - BSP_STATUS_FAIL            if bsp_dev_id is invalid, if any portion of I2C transaction
     * failed
     * - BSP_STATUS_OK              otherwise
     *
     */
    uint32_t (*i2c_db_write)(uint32_t bsp_dev_id, uint8_t *write_buffer_0,
                 uint32_t write_length_0, uint8_t *write_buffer_1,
                 uint32_t write_length_1, bsp_callback_t cb, void *cb_arg);

    /**
     * Perform a SPI read
     *
     * This function will write and then read back data from a SPI device with a register file.
     * Padding will automatically be added.
     *
     * Perform transaction in the order:
     * 1. SPI CS low
     * 2. SPI write of \b addr_length bytes from \b addr_buffer
     * 3. SPI write of pad_len padding clock cycles
     * 4. SPI read of \b data_length bytes into \b data_buffer
     * 5. SPI CS high
     *
     * BSP will decode \b bsp_dev_id to the correct SPI bus and SPI address.
     *
     * @param [in] bsp_dev_id       ID of the SPI device corresponding to the SPI peripheral to
     * reset
     * @param [in] addr_buffer      pointer to array of bytes to write
     * @param [in] addr_length      total number of bytes in \b write_buffer
     * @param [in] data_buffer      pointer to array of bytes to load with SPI bytes read
     * @param [in] data_length      total number of bytes to read into \b read_buffer
     * @param [in] pad_len          total number of bytes of padding between the addr write
     * transaction and the data read
     *
     * @return
     * - BSP_STATUS_FAIL            if bsp_dev_id is invalid, if any portion of SPI transaction
     * failed
     * - BSP_STATUS_OK              otherwise
     *
     */
    uint32_t (*spi_read)(uint32_t bsp_dev_id, uint8_t *addr_buffer, uint32_t addr_length,
                 uint8_t *data_buffer, uint32_t data_length, uint32_t pad_len);

    /**
     * Perform a SPI write
     *
     * This function will write data to a SPI device with a register file. Padding will
     * automatically be added.
     *
     * Perform transaction in the order:
     * 1. SPI CS low
     * 2. SPI write of \b addr_length bytes from \b addr_buffer
     * 3. SPI write of pad_len padding clock cycles
     * 4. SPI write of \b data_length bytes into \b data_buffer
     * 5. SPI CS high
     *
     * BSP will decode \b bsp_dev_id to the correct SPI bus and SPI address.
     *
     * @param [in] bsp_dev_id       ID of the SPI device corresponding to the SPI peripheral to
     * reset
     * @param [in] addr_buffer      pointer to array of bytes to write
     * @param [in] addr_length      total number of bytes in \b write_buffer
     * @param [in] data_buffer      pointer to array of bytes to load with SPI bytes read
     * @param [in] data_length      total number of bytes to read into \b read_buffer
     * @param [in] pad_len          total number of bytes of padding between the addr write
     * transaction and the data write
     *
     * @return
     * - BSP_STATUS_FAIL            if bsp_dev_id is invalid, if any portion of SPI transaction
     * failed
     * - BSP_STATUS_OK              otherwise
     *
     */
    uint32_t (*spi_write)(uint32_t bsp_dev_id, uint8_t *addr_buffer, uint32_t addr_length,
                  uint8_t *data_buffer, uint32_t data_length, uint32_t pad_len);

    /**
     * Global enable of interrupts
     *
     * Since this is MCU-platform specific, it is included as part of the BSP-Driver interface.
     *
     * @return
     * - BSP_STATUS_FAIL            if bsp_dev_id is invalid, if any portion of I2C transaction
     * failed
     * - BSP_STATUS_OK              otherwise
     *
     */
    uint32_t (*enable_irq)(void);

    /**
     * Global disable of interrupts
     *
     * Since this is MCU-platform specific, it is included as part of the BSP-Driver interface.
     *
     * @return
     * - BSP_STATUS_FAIL            if bsp_dev_id is invalid, if any portion of I2C transaction
     * failed
     * - BSP_STATUS_OK              otherwise
     *
     */
    uint32_t (*disable_irq)(void);

    /**
     * Temporarily change the clock speed of the SPI bus
     *
     * Since portions of a driver may have a maximum bus speed limitation, this API allows for
     * temporarily specifying the maximum bus speed.
     *
     * @return
     * - BSP_STATUS_FAIL            if a slower speed is requested by the current SPI speed is
     * already slowest available
     * - BSP_STATUS_OK              otherwise
     *
     */
    uint32_t (*spi_throttle_speed)(uint32_t speed_hz);

    /**
     * Restore the clock speed of the SPI bus to the original configuration
     *
     * After a call to spi_throttle_speed(), this API allows for restoring the bus clock speed
     * of the SPI bus to the original configuration given during BSP initialization.
     *
     * @return                      BSP_STATUS_OK always
     *
     */
    uint32_t (*spi_restore_speed)(void);
} bsp_driver_if_t;

enum cs40l5x_haptic_rom_bank {
    CS40L5X_HAPTIC_ROM_BUZZ_160,
    CS40L5X_HAPTIC_ROM_CLICK_1,
    CS40L5X_HAPTIC_ROM_CLICK_2,
    CS40L5X_HAPTIC_ROM_CLICK_3,
    CS40L5X_HAPTIC_ROM_CLICK_4,
    CS40L5X_HAPTIC_ROM_CLICK_5,
    CS40L5X_HAPTIC_ROM_CLICK_6,
    CS40L5X_HAPTIC_ROM_CLICK_7,
    CS40L5X_HAPTIC_ROM_CLICK_8,
    CS40L5X_HAPTIC_ROM_BUZZ_240,
    CS40L5X_HAPTIC_ROM_CLICK_1_VCM,
    CS40L5X_HAPTIC_ROM_CLICK_2_VCM,
    CS40L5X_HAPTIC_ROM_CLICK_3_VCM,
    CS40L5X_HAPTIC_ROM_CLICK_4_VCM,
    CS40L5X_HAPTIC_ROM_CLICK_5_VCM,
    CS40L5X_HAPTIC_ROM_CLICK_6_VCM,
    CS40L5X_HAPTIC_ROM_CLICK_7_VCM,
    CS40L5X_HAPTIC_ROM_CLICK_8_VCM,
    CS40L5X_HAPTIC_ROM_CLICK_9_VCM,
    CS40L5X_HAPTIC_ROM_CLICK_10_VCM,
    CS40L5X_HAPTIC_ROM_CLICK_11_VCM,
    CS40L5X_HAPTIC_ROM_CLICK_12_VCM,
    CS40L5X_HAPTIC_ROM_CLICK_13_VCM,
    CS40L5X_HAPTIC_ROM_CLICK_14_VCM,
    CS40L5X_HAPTIC_ROM_CLICK_15_VCM,
    CS40L5X_HAPTIC_ROM_ZIPPER,
    CS40L5X_HAPTIC_ROM_BUMP,
};

struct cs40l5x_haptic_source_config {
    int index;
    int bank;
};

struct cs40l5x_bsp {
    cs40l5x_t priv;
    struct cs40l5x_haptic_source_config hap_cfg;
};

extern bsp_driver_if_t *bsp_driver_if_g;

/**
 * Writes the contents of a single register/memory address via i2c
 *
 * @param [in] spec                 Pointer to the i2c struct reference
 * @param [in] reg_addr             32-bit address to be written
 * @param [in] value                32-bit value to be written
 *
 * @return
 * - -EIO                           on failure
 * - BSP_STATUS_OK                  otherwise
 *
 */
int cs40l5x_i2c_write_reg_dt(const struct i2c_dt_spec *spec, const uint32_t reg_addr,
                 const uint32_t value);

/**
 * Reads the contents of a single register/memory address via i2c
 *
 * @param [in] spec                 Pointer to the i2c struct reference
 * @param [in] reg_addr             32-bit address to be read
 * @param [out] value               Pointer to variable to read data into
 *
 * @return
 * - -EIO                           on failure
 * - BSP_STATUS_OK                  otherwise
 *
 */
int cs40l5x_i2c_read_reg_dt(const struct i2c_dt_spec *spec, const uint32_t reg_addr,
                uint32_t *value);

/**
 * Read-Modify-Write of register using 32-bit mask via i2c
 *
 * @param [in] spec                 Pointer to the i2c struct reference
 * @param [in] reg_addr             32-bit address to be read
 * @param [in] mask                 32-bit mask for bits to be modified
 * @param [in] value                32-bit value to be written
 *
 * @return
 * - BSP_STATUS_FAIL                on read failure
 * - BSP_STATUS_OK                  otherwise
 */
int cs40l5x_update_reg_dt(const struct i2c_dt_spec *spec, const uint32_t reg_addr,
              const uint32_t mask, const uint32_t value);

/**
 * Writes an array of addr/word pairs to its corresponding register/memory addresses via i2c
 *
 * @param [in] spec                 Pointer to the i2c struct reference
 * @param [in] array                Array of address/word pairs with the addr at array[i] and the
 * word at array[i+1]
 * @param [in] words                Size of array to be written (number of words * 2)
 *
 * @return
 * - BSP_STATUS_FAIL                on write failure
 * - BSP_STATUS_OK                  otherwise
 */
int cs40l5x_write_array_dt(const struct i2c_dt_spec *spec, const uint32_t *array, uint32_t words);

/**
 * Reads a register via i2c for a specific value for a set number of tries while waiting
 * between reads.
 *
 * @param [in] spec                 Pointer to the i2c struct reference
 * @param [in] reg_addr             Address to read from.
 * @param [in] value                Value to compare the read value to.
 * @param [in] tries                How many times to read the address.
 * @param [in] delay                How long to delay between each read.
 *
 * @return
 * - BSP_STATUS_FAIL                if the i2c read failed or if value not polled
 *                                  within the amount of tries
 * - BSP_STATUS_OK                  otherwise
 */
int cs40l5x_poll_reg_dt(const struct i2c_dt_spec *spec, const uint32_t reg_addr, uint32_t value,
            uint32_t tries, uint32_t delay);

/**
 * Write a value to a register via i2c and poll for an updated value
 *
 * @param [in] spec                 Pointer to the i2c struct reference
 * @param [in] reg_addr             Address to read from.
 * @param [in] val                  32-bit value to be written
 * @param [in] acked_val            Value to poll for after writing 'val'
 * @param [in] tries                How many times to read the address.
 * @param [in] delay                How long to delay between each read (ms)
 *
 * @return
 * - BSP_STATUS_FAIL                if the i2c write failed or if value not polled
 *                                  within the amount of tries
 * - BSP_STATUS_OK                  otherwise
 */
int cs40l5x_write_acked_reg_dt(const struct i2c_dt_spec *spec, const uint32_t reg_addr,
                   uint32_t val, uint32_t acked_val, uint8_t tries, uint32_t delay);

/**
 * Update the driver's current haptic configuration for haptic triggers
 *
 * @param [in] dev                  Pointer to the driver state
 * @param [in] hap_cfg              Haptic source data structure containing
 * effect bank and index
 *
 * @return
 * - BSP_STATUS_FAIL if dev or hap_cfg invalid
 * - BSP_STATUS_OK                  otherwise
 */
int cs40l5x_set_haptic_cfg(const struct device *dev, struct cs40l5x_haptic_source_config *hap_cfg);

/**
 * Update Vibration Compensation's input speed in kph (0-255)
 *
 * @param [in] dev                  Pointer to the driver state
 * @param [in] speed                Speed in kph
 *
 * @return
 * - BSP_STATUS_FAIL if dev or write failure
 * - BSP_STATUS_OK                  otherwise
 */
int cs40l5x_set_vibecomp_speed(const struct device *dev, uint32_t speed);

int bsp_cs40l5x_start_i2s(const struct device *dev);
int bsp_cs40l5x_stop_i2s(const struct device *dev);
#endif
```
