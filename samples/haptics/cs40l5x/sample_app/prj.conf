## CMakeLists.txt
```
# SPDX-License-Identifier: Apache-2.0
set(DRIVER_BASE "../../../..")
cmake_minimum_required(VERSION 3.20.0)

find_package(Zephyr REQUIRED HINTS $ENV{ZEPHYR_BASE})
project(cs40l5x)

FILE(GLOB app_sources src/*.c ${DRIVER_BASE}/cs40l5x/*.c ${DRIVER_BASE}/common/fw_img.c)
target_sources(app PRIVATE ${app_sources})

zephyr_library_add_dependencies(offsets_h)

zephyr_compile_definitions(CIRRUS_ZEPHYR_SAMPLE)

add_subdirectory(src)
```

## prj.conf
```kconfig
CONFIG_GPIO=y
CONFIG_LOG=y
CONFIG_HAPTICS=y
CONFIG_HAPTICS_CS40L5X_ALT_OS=y
CONFIG_HEAP_MEM_POOL_SIZE=8192

# Uncomment for Debug Shell
# CONFIG_SHELL=y
# CONFIG_I2C_SHELL=y

CONFIG_HAPTICS_CS40L51=y
# CONFIG_HAPTICS_CS40L52 is not set
# CONFIG_HAPTICS_CS40L53 is not set
```

## boards/nucleo_f401re.overlay
```dts
/*
 * Copyright (c) 2024 Cirrus Logic, Inc.
 *
 * SPDX-License-Identifier: Apache-2.0
 */

#include <zephyr/dt-bindings/i2c/i2c.h>

&usart1 {
	status = "disabled";
};
```

## src/main.c
```c
/*
 * Copyright (c) Cirrus Logic 2026 All Rights Reserved, http://www.cirrus.com/
 *
 * Licensed under the Apache License, Version 2.0 (the License); you may
 * not use this file except in compliance with the License.
 * You may obtain a copy of the License at
 *
 * www.apache.org/licenses/LICENSE-2.0
 *
 * Unless required by applicable law or agreed to in writing, software
 * distributed under the License is distributed on an AS IS BASIS, WITHOUT
 * WARRANTIES OR CONDITIONS OF ANY KIND, either express or implied.
 * See the License for the specific language governing permissions and
 * limitations under the License.
 *
 */

#include <errno.h>

#include <zephyr/device.h>
#include <zephyr/devicetree.h>
#include <zephyr/kernel.h>
#include <zephyr/logging/log.h>
#include <zephyr/drivers/haptics.h>
#include <zephyr/drivers/i2c.h>
//#include "drivers/haptics/cs40l5x.h"
#include <zephyr/drivers/uart.h>
#include <zephyr/sys/util.h>
#include <sys/_stdint.h>

#define LOG_LEVEL 4

#include "cs40l5x_bsp.h"

LOG_MODULE_REGISTER(main);

int main(void)
{
        int ret;
        char in_char;
        const struct device *cs40l5x = DEVICE_DT_GET(DT_NODELABEL(haptic1));
        const struct device *uart = DEVICE_DT_GET(DT_NODELABEL(usart2));
        struct cs40l5x_haptic_source_config hap_cfg = {
                .index = CS40L5X_HAPTIC_ROM_CLICK_1_VCM,
                .bank = ROM_BANK,
        };
        cs40l5x_set_haptic_cfg(cs40l5x, &hap_cfg);

        if (!cs40l5x) {
                LOG_ERR("CS40L5X device not found");
                return -ENODEV;
        } else if (!device_is_ready(cs40l5x)) {
                LOG_ERR("CS40L5X device %s is not ready", cs40l5x->name);
                //return -EIO;
        } else {
                LOG_INF("Found CS40L5X device %s", cs40l5x->name);
        }

        while (1) {

                ret = uart_poll_in(uart, &in_char);

                if (ret == 0) {
                        ret = haptics_start_output(cs40l5x);
                        if (ret < 0) {
                                LOG_ERR("Failed to start output: %d", ret);
                                return ret;
                        }
                }
                k_msleep(1);
        }

        return 0;
}
```

## src/cs40l53_firmware.c
```c
/**
 * @file cs40l53_firmware.c
 *
 * @brief CS40L53 Firmware C Array File
 *
 * @copyright
 * Copyright (c) Cirrus Logic 2026 All Rights Reserved, http://www.cirrus.com/
 *
 * Licensed under the Apache License, Version 2.0 (the License); you may
 * not use this file except in compliance with the License.
 * You may obtain a copy of the License at
 *
 * www.apache.org/licenses/LICENSE-2.0
 *
 * Unless required by applicable law or agreed to in writing, software
 * distributed under the License is distributed on an AS IS BASIS, WITHOUT
 * WARRANTIES OR CONDITIONS OF ANY KIND, either express or implied.
 * See the License for the specific language governing permissions and
 * limitations under the License.
 *
 */

/***********************************************************************************************************************
 * INCLUDES
 **********************************************************************************************************************/
#include "cs40l53_firmware.h"

/***********************************************************************************************************************
 * GLOBAL VARIABLES
 **********************************************************************************************************************/

/**
 * @defgroup CS40L53_FIRMWARE_MEMORY_BLOCKS
 * @brief Firmware memory blocks
 * @details
 * Trailing zero bytes may be appended to fill output words
 *
 * @{
 */
const uint8_t cs40l53_fw_block_0[] = {
0x00,0x04,0x00,0x00,0x00,0x02,0x03,0x00,0x1A,0x00,0xD4,0x00,0x78,0x04,0x00,0x03,0x00,0x22,0x00,0x08,0x00,0x01,0x8E,0x00,
0x10,0x00,0x00,0x01,0xF2,0x0F,0x00,0x00,0x01,0x00,0x02,0x09,0x0C,0x00,0x15,0x28,0x00,0x00,0x00,0x00,0x00,0x00,0x00,0x00,
0x00,0x09,0xF2,0x00,0x10,0x4D,0x01,0x01,0x00,0x00,0x14,0x00,0x00,0x00,0x00,0x00,0xF2,0x23,0x00,0x00,0x01,0x00,0x03,0x09,
0x0B,0x00,0x15,0x5A,0x00,0x00,0x00,0x00,0x00,0x00,0x00,0x00,0x00,0x09,0xF2,0x01,0x10,0x62,0x01,0x01,0x00,0x00,0x2D,0x00,
0x00,0x00,0x00,0x00,0xF2,0x03,0x00,0x00,0x01,0x01,0x07,0x09,0x05,0x00,0x10,0xB0,0x00,0x00,0x00,0x00,0x00,0x00,0x00,0x00,
0x00,0x09,0xF2,0x06,0x10,0xBA,0x02,0x00,0x00,0x01,0x18,0x00,0x00,0x00,0x00,0x00,0x01,0x42,0x00,0x00,0x01,0x01,0x03,0x09,
0x0A,0x00,0x0C,0x59,0x00,0x00,0x00,0x00,0x00,0x00,0x00,0x00,0x01,0x09,0xF2,0x2C,0x15,0x88,0x01,0x00,0x00,0x00,0x36,0x00,
0x00,0x00,0x00,0x00,0xF2,0x02,0x00,0x00,0x02,0x02,0x01,0x09,0x17,0x00,0x09,0xE8,0x00,0x00,0x00,0x00,0x00,0x00,0x00,0x00,
0x02,0x09,0x01,0x40,0x0C,0x24,0x01,0x00,0x00,0x00,0x0A,0x00,0x06,0x00,0x05,0x04,0xF2,0x1B,0x00,0x00,0x02,0x01,0x01,0x09,
0x41,0x00,0x0B,0xE3,0x00,0x00,0x00,0x00,0x00,0x00,0x00,0x00,0x00,0x09,0xF2,0x0C,0x0B,0xDA,0x03,0x01,0x00,0x00,0x09,0x00,
0x00,0x00,0x00,0x00,0x01,0x3D,0x00,0x00,0x01,0x01,0x00,0x09,0x4A,0x00,0x0C,0xFA,0x00,0x00,0x00,0x00,0x00,0x00,0x00,0x00,
0x00,0x09,0x01,0x3C,0x0C,0x2E,0x06,0x05,0x00,0x00,0x0C,0x00,0x00,0x00,0x00,0x00,0xF2,0x07,0x00,0x00,0x02,0x02,0x01,0x09,
0x02,0x00,0x00,0x86,0x04,0x04,0x00,0x00,0x00,0x00,0xFA,0x00,0x01,0x09,0x00,0xBD,0x17,0x00,0x05,0x01,0x00,0x07,0xE2,0x00,
0xD0,0x00,0x0C,0x00,0xDE,0xAD,0x00,0x07,0x12,0x34,0x56,0xBE,
};

const uint8_t cs40l53_fw_block_1[] = {
0x00,0xAB,0xCD,0xEF,0x00,0x12,0x34,0x56,0x00,0xAB,0xCD,0xEF,
};

const uint8_t cs40l53_fw_block_2[] = {
0x00,0x00,0x7C,0x00,0x20,0x38,0x00,0x00,0x00,0x00,0x00,0x00,0x00,0x01,0x00,0x00,0x2D,0x6C,0x00,0x00,0x00,0x00,0x00,0x00,
0x00,0x02,0x00,0x00,0x64,0x80,0x00,0x00,0x00,0x00,0x00,0x00,0xFD,0x3F,0xFF,0xFF,0x42,0x00,0xFF,0xFF,0x00,0x00,0x00,0x00,
0x00,0x00,0x44,0x0C,0x00,0x00,0x00,0x00,0xFF,0xFF,0xFF,0x7F,0xFF,0xFF,0xFF,0xFF,0x00,0x00,0x00,0x00,0x00,0x00,0x00,0x00,
};

const uint8_t cs40l53_fw_block_3[] = {
0x00,0x00,0x00,0x01,
};

const uint8_t cs40l53_fw_block_4[] = {
0x00,0x00,0x00,0x00,0x00,0x00,0x00,0x00,
};

const uint8_t cs40l53_fw_block_5[] = {
0x00,0x00,0x00,0x00,0x00,0x00,0x00,0x00,0x00,0x00,0x07,0x00,0x00,0x00,0x00,0x00,0x0C,0x8E,0x00,0x00,0x00,0x0F,0xE9,0x00,
};

const uint8_t cs40l53_fw_block_6[] = {
0x00,0x00,0x00,0x00,0x00,0x00,0x00,0x00,
};

const uint8_t cs40l53_fw_block_7[] = {
0x00,0x00,0x12,0xFA,0x00,0x1C,0x00,0x34,
};

const uint8_t cs40l53_fw_block_8[] = {
0x00,0x00,0x00,0xBE,0x00,0x5A,0xE3,0x63,0x00,0x00,0x00,0x00,0x00,0x00,0x00,0x00,0x00,0x00,0x00,0x00,0x00,0x21,0x4F,0xF9,
0x00,0x00,0x00,0x1C,0xCC,0x00,0x9A,0x50,0x00,0x1B,0x02,0x19,0x0F,0x74,0xC1,0xB0,0x40,0x20,0x52,0x80,0x20,0x52,0x89,0x9A,
0x00,0x00,0x9A,0x40,0x09,0x85,0x48,0x09,0x55,0x20,0x97,0xA0,0x40,0x20,0x52,0x90,0x17,0xA0,0x0A,0x9A,0xA4,0x02,0x55,0x20,
0x01,0x7A,0x01,0x09,0x05,0x29,0x85,0x52,0xA0,0x87,0xA0,0x09,0x09,0xA4,0x00,0x73,0xCC,0x00,0x73,0xA1,0x82,0x06,0x40,0x09,
0x06,0x34,0x88,0xCE,0x00,0x11,0x4F,0xE9,0x1C,0x01,0x22,0x1B,0xCF,0xFE,0x9C,0x80,0xE0,0x8F,0x40,0x01,0x9A,0x40,0xE0,0x01,
0x00,0x00,0x27,0x50,0x00,0x00,0x00,0x99,0x00,0x2E,0x00,0x50,0x00,0x9C,0x80,0x1C,0x8F,0x40,0x00,0x00,0x80,0x00,0x0F,0xD2,
0x00,0x00,0x00,0x9C,0x4F,0xD8,0x8F,0x40,0x01,0x1C,0x00,0x21,0x9D,0x80,0x00,0x00,0xFC,0x81,0xCF,0xFE,0x09,0x90,0x00,0x14,
0xB6,0x10,0x00,0x70,0x80,0x18,0xFE,0x08,0x1C,0x00,0x49,0xA4,0x00,0x01,0x4F,0xF9,0x01,0x0F,0x98,0x10,0x8F,0xF0,0x99,0x00,
0x6A,0x99,0x00,0x01,0x9C,0xC0,0x00,0x4F,0x00,0x06,0xE0,0xC0,0x3C,0x01,0x1B,0x00,0x00,0x00,0x9C,0x00,0x20,0x00,0x00,0x00,
0x99,0x00,0x00,0x89,0x04,0x60,0x00,0x00,0x09,0x90,0xC0,0x02,0xB0,0x21,0x00,0x00,0x4C,0x00,0xE0,0x01,0x9C,0xC0,0x00,0xF7,
0x00,0x01,0x00,0x00,0x00,0x10,0x41,0x1B,0xB0,0x00,0x99,0x0C,0x21,0x8F,0x00,0x21,0x10,0x01,0x01,0xB0,0xC0,0x00,0xF7,0x4C,
0x00,0x0E,0x40,0x9C,0x90,0xC0,0x99,0x0C,0x82,0x10,0x00,0x09,0x00,0xE8,0x18,0xF0,0x00,0x01,0x00,0x10,0x01,0xB0,0x21,0x1B,
0xF7,0x4C,0x8F,0x40,0xC0,0x9C,0xC0,0x00,0x99,0x0C,0x00,0x0E,0x00,0x01,0x85,0xE0,0x11,0x00,0x01,0x99,0x0F,0x00,0x8D,0x03,
0x08,0x99,0x0C,0x00,0x01,0xC1,0x67,0xC2,0x01,0x01,0xB0,0x00,0x00,0x0F,0x40,0x10,0xF7,0x4C,0x99,0x0C,0x21,0x9C,0xC0,0x00,
0x8F,0x40,0x01,0xB0,0x0C,0x00,0x0F,0x84,0x81,0x00,0x01,0x99,0xB0,0x00,0x86,0xD0,0x21,0x8F,0x00,0x21,0x17,0xF9,0x01,0xB0,
0xC0,0x00,0xF7,0x4C,0x00,0x0F,0x40,0x9C,0x00,0x10,0x99,0x0C,0x00,0x17,0xF8,0x01,0x00,0x00,0x09,0x90,0x88,0x00,0x0E,0x00,
0x00,0x7E,0x40,0x27,0x00,0x00,0x9A,0x00,0x20,0x8F,0x40,0x00,0x99,0x20,0x00,0x89,0x00,0x09,0x90,0x40,0x09,0x90,0x40,0x00,
0xCC,0x00,0x20,0x0A,0x00,0x18,0x71,0x09,0x00,0xEE,0x40,0x00,0xC0,0x00,0x11,0x6C,0x00,0x00,0x00,0x9C,0x0F,0x4C,0x8F,0x40,
0x07,0x9C,0xC0,0x00,0x00,0x00,0x00,0x18,0x00,0x00,0x00,0x00,0x00,0x0F,0x3A,0x00,0x10,0x65,0x9C,0xC0,0x00,0x00,0x00,0x00,
0x8F,0x40,0x00,0x00,0xC0,0x00,0x0F,0x1C,0x00,0x00,0x00,0x9C,0x78,0xC1,0x8F,0x40,0xA2,0x99,0x00,0x02,0x99,0x04,0x02,0x00,
0x04,0x02,0x00,0xC3,0x05,0xB0,0x08,0x99,0x90,0x40,0x8D,0x21,0x00,0x00,0xE0,0x19,0x20,0x06,0x19,0xA0,0xE4,0x00,0x1C,0x0F,
0x00,0x00,0x00,0x07,0x91,0x60,0x00,0x00,0x00,0x99,0x00,0x01,0x02,0x00,0x60,0x00,0x00,0x09,0xCC,0x00,0x60,0x00,0x00,0x00,
0x00,0x00,0x01,0x80,0xBA,0x01,0x00,0x50,0x9C,0xC0,0x00,0x07,0x40,0x00,0x00,0x00,0x02,0xB8,0x60,0x8F,0xAC,0xE1,0x99,0x04,
0x00,0x99,0x04,0x02,0x30,0x30,0x08,0xB8,0x02,0x17,0x3E,0x00,0x90,0x74,0x2D,0x08,0xB0,0x00,0x6E,0x00,0x4C,0x1B,0x02,0x11,
0x9C,0xC0,0x00,0xF7,0x0C,0x00,0x0F,0xC0,0x01,0xFF,0x00,0x99,0x00,0x01,0x9A,0x40,0x00,0x85,0x48,0x01,0x8F,0x00,0x21,0xB0,
0xD0,0x01,0xB0,0x21,0x00,0x10,0x81,0x88,0x81,0x04,0x99,0x0C,0xD4,0x7C,0x00,0x81,0x8F,0x40,0x01,0x4F,0xC0,0x00,0xF7,0x4C,
0x00,0x10,0x00,0x9C,0xFF,0xF8,0x99,0x0C,0x01,0x9A,0x40,0x00,0x85,0x48,0x01,0x00,0x00,0x86,0x34,0x00,0x00,0x10,0x81,0x7C,
0x78,0x44,0x99,0x0C,0xA1,0x99,0x00,0x02,0x99,0x04,0x02,0x00,0x04,0x02,0x00,0xC2,0x20,0x00,0x00,0x99,0x0E,0x04,0x8F,0x00,
0xE0,0x8D,0x20,0x00,0x99,0x04,0x02,0x00,0x98,0x01,0x4F,0xC1,0x02,0x75,0x00,0x86,0x00,0x00,0x99,0x00,0x00,0x00,0xE0,0x00,
0x8F,0x40,0x00,0x00,0xC0,0x00,0x0F,0x3A,0x01,0x4F,0xE9,0x9C,0x06,0x00,0x00,0x00,0x00,0x1C,0xFF,0xC0,0x9D,0x80,0x00,0x00,
0x58,0x00,0x00,0x00,0x00,0x3C,0xA0,0x00,0x3C,0xC0,0x99,0x14,0x10,0x99,0x10,0x00,0x90,0x14,0x00,0x80,0x40,0x00,0x00,0x00,
0x00,0x00,0x00,0x8F,0x00,0x00,0x00,0x00,0x00,0x00,0x00,0x00,0x00,0x00,0x00,0x00,
};

/** @} */

/**
 * Firmware memory block metadata
 */
const halo_boot_block_t cs40l53_fw_blocks[] = {
    {
        .address = 0x02000000,
        .block_size = 324,
        .bytes = cs40l53_fw_block_0
    },
    {
        .address = 0x028001B0,
        .block_size = 12,
        .bytes = cs40l53_fw_block_1
    },
    {
        .address = 0x02000150,
        .block_size = 72,
        .bytes = cs40l53_fw_block_2
    },
    {
        .address = 0x028021DC,
        .block_size = 4,
        .bytes = cs40l53_fw_block_3
    },
    {
        .address = 0x028030B8,
        .block_size = 8,
        .bytes = cs40l53_fw_block_4
    },
    {
        .address = 0x02002490,
        .block_size = 24,
        .bytes = cs40l53_fw_block_5
    },
    {
        .address = 0x028030E0,
        .block_size = 8,
        .bytes = cs40l53_fw_block_6
    },
    {
        .address = 0x03400794,
        .block_size = 8,
        .bytes = cs40l53_fw_block_7
    },
    {
        .address = 0x03800000,
        .block_size = 760,
        .bytes = cs40l53_fw_block_8
    },

};

/**
 * @defgroup CS40L53_COEFFICIENT_0_MEMORY_BLOCKS
 * @brief Coefficient _0 memory blocks
 * @details
 * Trailing zero bytes may be appended to fill output words
 *
 * @{
 */
const uint8_t cs40l53_coeff_0_block_0[] = {
0x00,0x00,0x00,0x0C,0x00,0x00,0x00,0x10,0x00,0x00,0x00,0x07,0x00,0x10,0x00,0x08,0x00,0x00,0x00,0x17,0x00,0x00,0x00,0x1C,
0x00,0x90,0x00,0x08,0x00,0x00,0x00,0x33,0x00,0x00,0x00,0x19,0x00,0x00,0x00,0x0C,0x00,0x00,0x00,0x4C,0x00,0x00,0x00,0x07,
0x00,0x00,0x00,0x0A,0x00,0x00,0x00,0x53,0x00,0x00,0x00,0x06,0x00,0xFF,0xFF,0xFF,0x00,0x80,0x00,0x50,0x00,0x00,0x64,0x00,
0x00,0x20,0x00,0x00,0x00,0x00,0x32,0x01,0x00,0x00,0x02,0x80,0x00,0x00,0x32,0x01,0x00,0x00,0x00,0x00,0x00,0x80,0x00,0x4E,
0x00,0x5F,0x00,0x74,0x00,0x00,0x07,0x0D,0x00,0x13,0x1A,0x1F,0x00,0x24,0x29,0x2D,0x00,0x30,0x32,0x34,0x00,0x34,0x34,0x34,
0x00,0x32,0x30,0x2D,0x00,0x29,0x24,0x1F,0x00,0x1A,0x13,0x0D,0x00,0x07,0x00,0xF9,0x00,0xF3,0xEC,0xE6,0x00,0xE0,0xDB,0xD7,
0x00,0xD3,0xD0,0xCE,0x00,0xCC,0xCB,0xCB,0x00,0xCC,0xCE,0xD0,0x00,0xD3,0xD7,0xDB,0x00,0xE0,0xE6,0xEC,0x00,0xF3,0xF9,0x00,
0x00,0x07,0x0D,0x13,0x00,0x1A,0x1F,0x24,0x00,0x29,0x2D,0x30,0x00,0x32,0x34,0x34,0x00,0x34,0x34,0x32,0x00,0x30,0x2D,0x29,
0x00,0x24,0x1F,0x1A,0x00,0x13,0x0D,0x07,0x00,0x00,0xF9,0xF3,0x00,0x80,0x00,0x45,0x00,0x46,0x00,0x74,0x00,0x01,0x08,0x11,
0x00,0x1A,0x24,0x2D,0x00,0x33,0x39,0x3D,0x00,0x3F,0x41,0x42,0x00,0x43,0x44,0x44,0x00,0x43,0x42,0x41,0x00,0x3E,0x39,0x2E,
0x00,0x1C,0x02,0xE7,0x00,0xD3,0xC7,0xC1,0x00,0xBC,0xBB,0xBA,0x00,0xBA,0xBA,0xBA,0x00,0xBA,0xBC,0xC1,0x00,0xD4,0x0F,0x42,
0x00,0x45,0x46,0x2B,0x00,0xF2,0xCE,0xC0,0x00,0xBC,0xBA,0xBA,0x00,0xBA,0xBA,0xBA,0x00,0xBC,0xBF,0xC4,0x00,0xCA,0xD1,0xD9,
0x00,0xE0,0xE8,0xEE,0x00,0xF4,0xF8,0xFB,0x00,0xFD,0xFF,0xFF,0x00,0x00,0x00,0x00,0x00,0x80,0x00,0xA0,0x00,0x00,0x64,0x00,
0x00,0x20,0x00,0x03,0x00,0x33,0x32,0x01,0x00,0x00,0x05,0x03,0x00,0x33,0x32,0x01,0x00,0x00,0x00,0x00,0x00,0x80,0x1F,0xCA,
0x00,0x00,0x02,0x00,0x00,0x64,0x02,0x00,0x00,0x00,0x00,0xFA,0x00,0x46,0x02,0x00,0x00,0x00,0x02,0xEE,
};

const uint8_t cs40l53_coeff_0_block_1[] = {
0x00,0xFF,0xFF,0xFF,
};

const uint8_t cs40l53_coeff_0_block_2[] = {
0x00,0x00,0x00,0x01,0x00,0x00,0x20,0xC5,0x00,0x00,0x00,0x30,0x00,0x00,0x00,0x05,0x00,0x00,0x12,0xC0,
};

const uint8_t cs40l53_coeff_0_block_3[] = {
0x00,0x00,0x20,0x00,0x00,0x00,0x40,0x00,0x00,0x7F,0xE0,0x00,0x00,0x7F,0xE0,0x00,0x00,0x7F,0xE0,0x00,0x00,0x7F,0xE0,0x00,
0x00,0x7F,0xE0,0x00,0x00,0x7F,0xE0,0x00,0x00,0x7F,0xE0,0x00,0x00,0x7F,0xE0,0x00,0x00,0x7F,0xE0,0x00,0x00,0x7F,0xE0,0x00,
0x00,0x7F,0xE0,0x00,0x00,0x7F,0xE0,0x00,0x00,0x7F,0xE0,0x00,0x00,0x7F,0xE0,0x00,0x00,0x7F,0xE0,0x00,0x00,0x7F,0xE0,0x00,
0x00,0x7F,0xE0,0x00,0x00,0x7F,0xE0,0x00,0x00,0x00,0x00,0x00,0x00,0x00,0x00,0x00,0x00,0x00,0x00,0x00,0x00,0x00,0x00,0x00,
0x00,0x00,0x00,0x00,0x00,0x00,0x00,0x00,0x00,0x00,0x00,0x00,0x00,0x00,0x00,0x00,0x00,0x00,0x00,0x00,0x00,0x00,0x00,0x00,
0x00,0x00,0x00,0x00,0x00,0x00,0x00,0x00,0x00,0x00,0x00,0x00,0x00,0x00,0x00,0x00,0x00,0x00,0x00,0x00,0x00,0x00,0x00,0x00,
0x00,0x00,0x00,0x00,0x00,0x00,0x00,0x00,0x00,0x00,0x00,0x00,0x00,0x00,0x00,0x00,0x00,0x00,0x00,0x64,0x00,0x00,0x00,0x64,
0x00,0x00,0x00,0x64,0x00,0x00,0x00,0x64,0x00,0x00,0x00,0x64,0x00,0x00,0x00,0x64,0x00,0x00,0x00,0x64,0x00,0x00,0x00,0x64,
0x00,0x00,0x00,0x64,0x00,0x00,0x00,0x64,0x00,0x00,0x00,0x64,0x00,0x00,0x00,0x64,0x00,0x00,0x00,0x64,0x00,0x00,0x00,0x64,
0x00,0x00,0x00,0x64,0x00,0x00,0x00,0x64,0x00,0x00,0x00,0x64,0x00,0x00,0x00,0x64,0x00,0x00,0x00,0x64,0x00,0x00,0x00,0x64,
};

const uint8_t cs40l53_coeff_0_block_4[] = {
0x00,0x00,0x00,0x03,0x00,0x00,0x08,0x03,0x00,0x00,0x00,0x0D,0x00,0x00,0x0C,0x0D,0x00,0x00,0x00,0x11,0x00,0x00,0x0C,0x11,
0x00,0x00,0x00,0x13,0x00,0x00,0x0C,0x13,0x00,0x00,0x00,0x0E,0x00,0x00,0x0C,0x0E,0x00,0x00,0x00,0x0F,0x00,0x00,0x0C,0x0F,
0x00,0x00,0x00,0x05,0x00,0x00,0x08,0x05,0x00,0x00,0x00,0x17,0x00,0x00,0x0C,0x17,
};

/** @} */

/**
 * Coefficient _0 memory block metadata
 */
const halo_boot_block_t cs40l53_coeff_0_blocks[] = {
    {
        .address = 0x02805C48,
        .block_size = 356,
        .bytes = cs40l53_coeff_0_block_0
    },
    {
        .address = 0x03403000,
        .block_size = 4,
        .bytes = cs40l53_coeff_0_block_1
    },
    {
        .address = 0x02802F8C,
        .block_size = 20,
        .bytes = cs40l53_coeff_0_block_2
    },
    {
        .address = 0x02802FA0,
        .block_size = 240,
        .bytes = cs40l53_coeff_0_block_3
    },
    {
        .address = 0x02804140,
        .block_size = 64,
        .bytes = cs40l53_coeff_0_block_4
    },

};


/***********************************************************************************************************************
 * LOCAL FUNCTIONS
 **********************************************************************************************************************/

/***********************************************************************************************************************
 * API FUNCTIONS
 **********************************************************************************************************************/
```

## src/cs40l53_firmware.h
```c
/**
 * @file cs40l53_firmware.h
 *
 * @brief CS40L53 Firmware C Header File
 *
 * @copyright
 * Copyright (c) Cirrus Logic 2026 All Rights Reserved, http://www.cirrus.com/
 *
 * Licensed under the Apache License, Version 2.0 (the License); you may
 * not use this file except in compliance with the License.
 * You may obtain a copy of the License at
 *
 * www.apache.org/licenses/LICENSE-2.0
 *
 * Unless required by applicable law or agreed to in writing, software
 * distributed under the License is distributed on an AS IS BASIS, WITHOUT
 * WARRANTIES OR CONDITIONS OF ANY KIND, either express or implied.
 * See the License for the specific language governing permissions and
 * limitations under the License.
 *
 * firmware_converter.py SDK version: 4.30.4 - internal
 * Command:  ../../../../../tools/firmware_converter/firmware_converter.py export cs40l53 ../../../../../cs40l5x/fw/CS40L53_Rev4.0.3.wmfw --wmdr ../tunings/cs40l5x_wt.bin
 *
 */

#ifndef CS40L53_FIRMWARE_H
#define CS40L53_FIRMWARE_H

/***********************************************************************************************************************
 * INCLUDES
 **********************************************************************************************************************/
#include <stdint.h>

/***********************************************************************************************************************
 * LITERALS & CONSTANTS
 **********************************************************************************************************************/

/**
 * @defgroup CS40L53_FIRMWARE_META
 * @brief Firmware meta data
 *
 * @{
 */
#define CS40L53_FIRMWARE_ID  0x1A00D4
/** @} */

/**
 * Coefficient payload is included
 */
#define CS40L53_LOAD_COEFFICIENTS

/**
 * Binary payload is included
 */
#define CS40L53_LOAD_BINARY

/**
 * @defgroup CS40L53_ALGORITHMS
 * @brief Defines indicating presence of HALO Core Algorithms
 *
 * @{
 */
#define CS40L53_ALGORITHM_FIRMWARE_CS40L5X
#define CS40L53_ALGORITHM_MDSYNC
#define CS40L53_ALGORITHM_EVENT_HANDLER
#define CS40L53_ALGORITHM_EVENT_LOGGER
#define CS40L53_ALGORITHM_GPIO
#define CS40L53_ALGORITHM_MAILBOX
#define CS40L53_ALGORITHM_PM
#define CS40L53_ALGORITHM_SHORT_DETECT
#define CS40L53_ALGORITHM_BOOSTEMP
#define CS40L53_ALGORITHM_BUZZGEN
#define CS40L53_ALGORITHM_DVL
#define CS40L53_ALGORITHM_DYNAMIC_F0
#define CS40L53_ALGORITHM_F0_ESTIMATION
#define CS40L53_ALGORITHM_HAPTICS_LOGGER
#define CS40L53_ALGORITHM_HAPTICS_SYSTEM
#define CS40L53_ALGORITHM_SVC
#define CS40L53_ALGORITHM_VIBEGEN
/** @} */

/**
 * @defgroup CS40L53_FIRMWARE_CONTROL_ADDRESSES
 * @brief Firmware control parameter addresses
 *
 * @{
 */
#define CS40L53_FIRMWARE_REVISION 0x2800010

//Definitions for FIRMWARE_CS40L5X Controls
#define FIRMWARE_CS40L5X_HALO_STATE 0x28021E0
#define FIRMWARE_CS40L5X_HALO_HEARTBEAT 0x28021E4
#define FIRMWARE_CS40L5X_POWER_MODE 0x28021E8
#define FIRMWARE_CS40L5X_AUDIO_BLK_SIZE 0x28021EC
#define FIRMWARE_CS40L5X_USER_CONTROL_INPUT 0x2802204
#define FIRMWARE_CS40L5X_USER_CONTROL_RESPONSE 0x2802208
#define FIRMWARE_CS40L5X_WATCHDOG_BOOT_THRESH 0x280220C
#define FIRMWARE_CS40L5X_WATCHDOG_RUN_THRESH 0x2802210
#define FIRMWARE_CS40L5X_POTP_MEM_CONF 0x2802214
#define FIRMWARE_CS40L5X_HAPTICS_OR_AUDIO 0x2802218
#define FIRMWARE_CS40L5X_REFCLK_SRC 0x280221C
#define FIRMWARE_CS40L5X_PLL_REFCLK_FREQ 0x2802220
#define FIRMWARE_CS40L5X_I2S_EN 0x2802224
#define FIRMWARE_CS40L5X_MDSYNC_ENABLED 0x2802228
#define FIRMWARE_CS40L5X_BOOT_REASON 0x280222C
#define FIRMWARE_CS40L5X_REFCLK_DETECT_32K 0x2802230
#define FIRMWARE_CS40L5X_PLL_TRIM_SAVED 0x2802234
#define FIRMWARE_CS40L5X_REDC_PLAYTIME_MS 0x2802238
#define FIRMWARE_CS40L5X_PRAM_CRC_RESULT 0x280223C
#define FIRMWARE_CS40L5X_CURRENT_DUCK_ENABLE 0x2802240
#define FIRMWARE_CS40L5X_HAPTICS_MODE 0x2802244
#define FIRMWARE_CS40L5X_HAPTICS_STATE 0x2802248
#define FIRMWARE_CS40L5X_HW_CLOCK_STATE 0x280224C
#define FIRMWARE_CS40L5X_SHUTDOWN_REQUESTED 0x2802250
#define FIRMWARE_CS40L5X_MIPS_OVERRUN_FLAG 0x2802254
#define FIRMWARE_CS40L5X_MIPS_OVERRUN_HB_NUM 0x2802258
#define FIRMWARE_CS40L5X_NUM_ACTIVE_STRM_MASTERS 0x280225C
#define FIRMWARE_CS40L5X_NUM_ACTIVE_STRM_CHANNELS 0x2802260
#define FIRMWARE_CS40L5X_P_NMI_DEBUG 0x2802264
#define FIRMWARE_CS40L5X_PLACE_HOLDER 0x3400638

//Definitions for MDSYNC Controls
#define MDSYNC_MDSYNC_TX_ID 0x28054A0
#define MDSYNC_MDSYNC_LSW_TX_ERR_CNT 0x28054A4
#define MDSYNC_MDSYNC_LSW_RX_ERR_CNT 0x28054A8
#define MDSYNC_MDSYNC_SW_TX_ERR_CNT 0x28054AC
#define MDSYNC_MDSYNC_SW_RX_ERR_CNT 0x28054B0
#define MDSYNC_LAST_ERR 0x28054B4
#define MDSYNC_LAST_LSW_RX 0x28054B8
//MDSYNC_LAST_LSW_RX size: 8 bytes
#define MDSYNC_LAST_SW_RX 0x28054C0
//MDSYNC_LAST_SW_RX size: 8 bytes

//Definitions for EVENT_HANDLER Controls
#define EVENT_HANDLER_DLER_XM_STRUCT_T 0x2804134
//EVENT_HANDLER_DLER_XM_STRUCT_T size: 80 bytes
#define EVENT_HANDLER_EVENT_POST_COUNT 0x2804134
#define EVENT_HANDLER_EVENTQ_PUSH_COUNT 0x2804138
#define EVENT_HANDLER_EVENTQ_POP_COUNT 0x280413C
#define EVENT_HANDLER_EVENT_MAP_TABLE_EVENT_DATA_PACKED 0x2804140
//EVENT_HANDLER_EVENT_MAP_TABLE_EVENT_DATA_PACKED size: 64 bytes
#define EVENT_HANDLER_EVENT_MAP_TABLE_INIT_FROM_OTP 0x2804180

//Definitions for EVENT_LOGGER Controls
#define EVENT_LOGGER_EVENT_LOG_HEADER 0x2805568
//EVENT_LOGGER_EVENT_LOG_HEADER size: 24 bytes
#define EVENT_LOGGER_ENABLED 0x2805580
#define EVENT_LOGGER_BUFFER_STATUS 0x2805584
#define EVENT_LOGGER_START_STREAM_OFFSET 0x2805588
#define EVENT_LOGGER_WAS_DISABLED 0x280558C
#define EVENT_LOGGER_TIMESTAMP_SHIFT 0x2805590

//Definitions for GPIO Controls
#define GPIO_GPIO_XM_STRUCT_T 0x2804188
//GPIO_GPIO_XM_STRUCT_T size: 180 bytes
#define GPIO_GPIO_INTERRUPT_COUNTER 0x2804188
//GPIO_GPIO_INTERRUPT_COUNTER size: 104 bytes
#define GPIO_GPI_ENABLE_BITMASK 0x28041F0
#define GPIO_GPO_ENABLE_BITMASK 0x28041F4
#define GPIO_SUP_GPI_COUNT 0x28041F8
#define GPIO_SUP_GPI 0x28041FC
//GPIO_SUP_GPI size: 32 bytes
#define GPIO_GPI_DEBOUNCE_TIME 0x280421C
//GPIO_GPI_DEBOUNCE_TIME size: 32 bytes
#define GPIO_PLACE_HOLDER 0x3400000

//Definitions for MAILBOX Controls
#define MAILBOX_QUEUE_BASE 0x28042C0
#define MAILBOX_QUEUE_LEN 0x28042C4
#define MAILBOX_QUEUE_WT 0x28042C8
#define MAILBOX_QUEUE_RD 0x28042CC
#define MAILBOX_STATUS 0x28042D0

//Definitions for PM Controls
#define PM_PM_XM_STRUCT_T 0x28042E8
//PM_PM_XM_STRUCT_T size: 1120 bytes
#define PM_PM_TIMER_TIMEOUT_TICKS 0x28042E8
//PM_PM_TIMER_TIMEOUT_TICKS size: 32 bytes
#define PM_PM_CUR_STATE 0x2804308
#define PM_PM_TIMER_ENABLED 0x280430C
#define PM_PM_STATE_LOCKS 0x2804310
//PM_PM_STATE_LOCKS size: 16 bytes
#define PM_POWER_ON_SEQUENCE 0x2804320
//PM_POWER_ON_SEQUENCE size: 800 bytes
#define PM_ACTIVE_SEQUENCE 0x2804640
//PM_ACTIVE_SEQUENCE size: 132 bytes
#define PM_ACTIVE_SEQUENCE1 0x2804640
#define PM_ACTIVE_SEQUENCE2 0x2804644
#define PM_ACTIVE_SEQUENCE3 0x2804648
#define PM_ACTIVE_SEQUENCE4 0x280464C
#define PM_ACTIVE_SEQUENCE5 0x2804650
#define PM_ACTIVE_SEQUENCE6 0x2804654
#define PM_ACTIVE_SEQUENCE7 0x2804658
#define PM_ACTIVE_SEQUENCE8 0x280465C
#define PM_ACTIVE_SEQUENCE9 0x2804660
#define PM_ACTIVE_SEQUENCE10 0x2804664
#define PM_ACTIVE_SEQUENCE11 0x2804668
#define PM_ACTIVE_SEQUENCE12 0x280466C
#define PM_ACTIVE_SEQUENCE13 0x2804670
#define PM_ACTIVE_SEQUENCE14 0x2804674
#define PM_ACTIVE_SEQUENCE15 0x2804678
#define PM_ACTIVE_SEQUENCE16 0x280467C
#define PM_ACTIVE_SEQUENCE17 0x2804680
#define PM_ACTIVE_SEQUENCE18 0x2804684
#define PM_ACTIVE_SEQUENCE19 0x2804688
#define PM_ACTIVE_SEQUENCE20 0x280468C
#define PM_ACTIVE_SEQUENCE21 0x2804690
#define PM_ACTIVE_SEQUENCE22 0x2804694
#define PM_ACTIVE_SEQUENCE23 0x2804698
#define PM_ACTIVE_SEQUENCE24 0x280469C
#define PM_ACTIVE_SEQUENCE25 0x28046A0
#define PM_ACTIVE_SEQUENCE26 0x28046A4
#define PM_ACTIVE_SEQUENCE27 0x28046A8
#define PM_ACTIVE_SEQUENCE28 0x28046AC
#define PM_ACTIVE_SEQUENCE29 0x28046B0
#define PM_ACTIVE_SEQUENCE30 0x28046B4
#define PM_ACTIVE_SEQUENCE31 0x28046B8
#define PM_ACTIVE_SEQUENCE32 0x28046BC
#define PM_ACTIVE_SEQUENCE33 0x28046C0
#define PM_STANDBY_SEQUENCE 0x28046C4
//PM_STANDBY_SEQUENCE size: 132 bytes
#define PM_STANDBY_SEQUENCE1 0x28046C4
#define PM_STANDBY_SEQUENCE2 0x28046C8
#define PM_STANDBY_SEQUENCE3 0x28046CC
#define PM_STANDBY_SEQUENCE4 0x28046D0
#define PM_STANDBY_SEQUENCE5 0x28046D4
#define PM_STANDBY_SEQUENCE6 0x28046D8
#define PM_STANDBY_SEQUENCE7 0x28046DC
#define PM_STANDBY_SEQUENCE8 0x28046E0
#define PM_STANDBY_SEQUENCE9 0x28046E4
#define PM_STANDBY_SEQUENCE10 0x28046E8
#define PM_STANDBY_SEQUENCE11 0x28046EC
#define PM_STANDBY_SEQUENCE12 0x28046F0
#define PM_STANDBY_SEQUENCE13 0x28046F4
#define PM_STANDBY_SEQUENCE14 0x28046F8
#define PM_STANDBY_SEQUENCE15 0x28046FC
#define PM_STANDBY_SEQUENCE16 0x2804700
#define PM_STANDBY_SEQUENCE17 0x2804704
#define PM_STANDBY_SEQUENCE18 0x2804708
#define PM_STANDBY_SEQUENCE19 0x280470C
#define PM_STANDBY_SEQUENCE20 0x2804710
#define PM_STANDBY_SEQUENCE21 0x2804714
#define PM_STANDBY_SEQUENCE22 0x2804718
#define PM_STANDBY_SEQUENCE23 0x280471C
#define PM_STANDBY_SEQUENCE24 0x2804720
#define PM_STANDBY_SEQUENCE25 0x2804724
#define PM_STANDBY_SEQUENCE26 0x2804728
#define PM_STANDBY_SEQUENCE27 0x280472C
#define PM_STANDBY_SEQUENCE28 0x2804730
#define PM_STANDBY_SEQUENCE29 0x2804734
#define PM_STANDBY_SEQUENCE30 0x2804738
#define PM_STANDBY_SEQUENCE31 0x280473C
#define PM_STANDBY_SEQUENCE32 0x2804740
#define PM_STANDBY_SEQUENCE33 0x2804744

//Definitions for SHORT_DETECT Controls
#define SHORT_DETECT_TECT_XM_STRUCT_T 0x2803164
//SHORT_DETECT_TECT_XM_STRUCT_T size: 40 bytes
#define SHORT_DETECT_PERMANENT_ENABLE 0x2803164
#define SHORT_DETECT_PERMANENT_FRAMES 0x2803168
#define SHORT_DETECT_PERMANENT_IMON_VOL 0x280316C
#define SHORT_DETECT_RUNTIME_ENABLE 0x2803170
#define SHORT_DETECT_RUNTIME_WINDOW_SIZE_FRAMES 0x2803174
#define SHORT_DETECT_RUNTIME_MAX_CONDUCTANCE 0x2803178
#define SHORT_DETECT_RUNTIME_IMON_HEADROOM 0x280317C
#define SHORT_DETECT_RUNTIME_SAMPLE_THRESHOLD 0x2803180
#define SHORT_DETECT_RUNTIME_USE_IMON_CLIPPED 0x2803184
#define SHORT_DETECT_SHORT_DETECTED 0x2803188

//Definitions for BOOSTEMP Controls
#define BOOSTEMP_TEMP_XM_STRUCT_T 0x2805620
//BOOSTEMP_TEMP_XM_STRUCT_T size: 216 bytes
#define BOOSTEMP_BOOSTEMP_CTRL_STRUCT_TEMPMON_WARN_THRESHOLD 0x2805624
#define BOOSTEMP_BOOSTEMP_CTRL_STRUCT_TEMPMON_ERROR_THRESHOLD 0x2805628
#define BOOSTEMP_BOOSTEMP_CTRL_STRUCT_FIRMWARE_BOOSTEMP_EN 0x280562C
#define BOOSTEMP_BOOSTEMP_CTRL_STRUCT_RSPK 0x28056F0
#define BOOSTEMP_BOOSTEMP_CTRL_STRUCT_BOOST_TEMP_EST 0x28056F4

//Definitions for BUZZGEN Controls
#define BUZZGEN_BUZZ_EFFECTS1_BUZZ_FREQ 0x28027A0
#define BUZZGEN_BUZZ_EFFECTS1_BUZZ_LEVEL 0x28027A4
#define BUZZGEN_BUZZ_EFFECTS1_BUZZ_DURATION 0x28027A8
#define BUZZGEN_BUZZ_EFFECTS2_BUZZ_FREQ 0x28027AC
#define BUZZGEN_BUZZ_EFFECTS2_BUZZ_LEVEL 0x28027B0
#define BUZZGEN_BUZZ_EFFECTS2_BUZZ_DURATION 0x28027B4
#define BUZZGEN_BUZZ_EFFECTS3_BUZZ_FREQ 0x28027B8
#define BUZZGEN_BUZZ_EFFECTS3_BUZZ_LEVEL 0x28027BC
#define BUZZGEN_BUZZ_EFFECTS3_BUZZ_DURATION 0x28027C0
#define BUZZGEN_BUZZ_EFFECTS4_BUZZ_FREQ 0x28027C4
#define BUZZGEN_BUZZ_EFFECTS4_BUZZ_LEVEL 0x28027C8
#define BUZZGEN_BUZZ_EFFECTS4_BUZZ_DURATION 0x28027CC
#define BUZZGEN_BUZZ_EFFECTS5_BUZZ_FREQ 0x28027D0
#define BUZZGEN_BUZZ_EFFECTS5_BUZZ_LEVEL 0x28027D4
#define BUZZGEN_BUZZ_EFFECTS5_BUZZ_DURATION 0x28027D8
#define BUZZGEN_BUZZ_EFFECTS6_BUZZ_FREQ 0x28027DC
#define BUZZGEN_BUZZ_EFFECTS6_BUZZ_LEVEL 0x28027E0
#define BUZZGEN_BUZZ_EFFECTS6_BUZZ_DURATION 0x28027E4
#define BUZZGEN_TRIGGER_BUZZ 0x28027E8
#define BUZZGEN_DURATION_RESOLUTION 0x28027EC
#define BUZZGEN_EVENT_COUNT 0x28027F0
#define BUZZGEN_AMPLITUDE_SCALING_FACTOR 0x28027F4
#define BUZZGEN_BUZZ_PENDING 0x28027F8

//Definitions for DVL Controls
#define DVL_DVL_XM_STRUCT_T 0x2803090
//DVL_DVL_XM_STRUCT_T size: 40 bytes
#define DVL_EN 0x2803090
#define DVL_ATK_GAIN_LIMITER_COEF 0x2803094
#define DVL_REL_GAIN_LIMITER_COEF 0x2803098
#define DVL_LRA_OVER_MAX 0x280309C
#define DVL_LRA_SAT 0x28030A0
#define DVL_MAG_REL_COEF 0x28030A4
#define DVL_HOLD_OFF_PERIOD_MS 0x28030A8
#define DVL_HOLD_OFF_THRESHOLD 0x28030AC
#define DVL_DEBUG_MAG_ENV 0x28030B0
#define DVL_DEBUG_GAIN_BUF_PTR 0x28030B4
#define DVL_DVL_YM_STRUCT_T 0x3401410
//DVL_DVL_YM_STRUCT_T size: 24 bytes
#define DVL_YM_PEQ_COEF1_X 0x3401410
#define DVL_YM_PEQ_COEF1_Y 0x3401414
#define DVL_YM_PEQ_COEF2_X 0x3401418
#define DVL_YM_PEQ_COEF2_Y 0x340141C
#define DVL_YM_PEQ_COEF3_X 0x3401420
#define DVL_YM_PEQ_COEF3_Y 0x3401424

//Definitions for DYNAMIC_F0 Controls
#define DYNAMIC_F0_C_F0_XM_STRUCT_T 0x2802F8C
//DYNAMIC_F0_C_F0_XM_STRUCT_T size: 260 bytes
#define DYNAMIC_F0_DYNAMIC_F0_ENABLED 0x2802F8C
#define DYNAMIC_F0_IMONRINGPPTHRESHOLD 0x2802F90
#define DYNAMIC_F0_FRME_SKIP 0x2802F94
#define DYNAMIC_F0_NUM_PEAKS_TOFIND 0x2802F98
#define DYNAMIC_F0_TIMEOUT_SMP 0x2802F9C
#define DYNAMIC_F0_DYN_F0_TABLE 0x2802FA0
//DYNAMIC_F0_DYN_F0_TABLE size: 240 bytes

//Definitions for F0_ESTIMATION Controls
#define F0_ESTIMATION_TION_XM_STRUCT_T 0x2802F68
//F0_ESTIMATION_TION_XM_STRUCT_T size: 36 bytes
#define F0_ESTIMATION_VOUT_VMON_SCALE 0x2802F68
#define F0_ESTIMATION_VMON_IMON_FS_RATIO 0x2802F6C
#define F0_ESTIMATION_FREQ_SPAN 0x2802F70
#define F0_ESTIMATION_FREQ_CENTRE 0x2802F74
#define F0_ESTIMATION_CHIRP_AMP 0x2802F78
#define F0_ESTIMATION_REDC 0x2802F7C
#define F0_ESTIMATION_TONE_DURATION_MS 0x2802F80
#define F0_ESTIMATION_F0_EST 0x2802F84
#define F0_ESTIMATION_Q_EST 0x2802F88
#define F0_ESTIMATION_TION_YM_STRUCT_T 0x3400000
//F0_ESTIMATION_TION_YM_STRUCT_T size: 8 bytes
#define F0_ESTIMATION_Z_MAX 0x3400000
#define F0_ESTIMATION_BEMF_MAX 0x3400004

//Definitions for HAPTICS_LOGGER Controls
#define HAPTICS_LOGGER_GGER_XM_STRUCT_T 0x28033E8
//HAPTICS_LOGGER_GGER_XM_STRUCT_T size: 296 bytes
#define HAPTICS_LOGGER_ENABLE 0x28033E8
#define HAPTICS_LOGGER_COUNT 0x28033F0
#define HAPTICS_LOGGER_FRAMESPERCAPTUREWINDOW 0x28033FC
#define HAPTICS_LOGGER_SOURCE 0x2803400
//HAPTICS_LOGGER_SOURCE size: 64 bytes
#define HAPTICS_LOGGER_DATA 0x2803440
//HAPTICS_LOGGER_DATA size: 192 bytes
#define HAPTICS_LOGGER_STREAM 0x2803500
//HAPTICS_LOGGER_STREAM size: 12 bytes

//Definitions for HAPTICS_SYSTEM Controls
#define HAPTICS_SYSTEM_TICS_XM_STRUCT_T 0x28030B8
//HAPTICS_SYSTEM_TICS_XM_STRUCT_T size: 48 bytes
#define HAPTICS_SYSTEM_SOURCE_ATTENUATION 0x28030B8
#define HAPTICS_SYSTEM_HAPTICS_SYSTEM_FLAGS 0x28030BC
#define HAPTICS_SYSTEM_SOURCE_INVERT 0x28030C0
#define HAPTICS_SYSTEM_BOOSTCONFIGEN 0x28030C4
#define HAPTICS_SYSTEM_BOOST_DISABLE_DELAY 0x28030C8
#define HAPTICS_SYSTEM_COND_CLASS_H_EN_FLAGS 0x28030CC
#define HAPTICS_SYSTEM_REFCLK_PLL_FREQ_MCLK 0x28030D0
#define HAPTICS_SYSTEM_RESYNC_SA_ERR_COUNTER 0x28030D4
#define HAPTICS_SYSTEM_LOGGER_SVC_BEMF 0x28030D8
#define HAPTICS_SYSTEM_LOGGER_VBST 0x28030DC
#define HAPTICS_SYSTEM_LOGGER_VMON 0x28030E0
#define HAPTICS_SYSTEM_PROJECT_ID 0x28030E4

//Definitions for SVC Controls
#define SVC_SVC_XM_STRUCT_T 0x2800218
//SVC_SVC_XM_STRUCT_T size: 8 bytes
#define SVC_TUNING_ID 0x2800218
//SVC_TUNING_ID size: 8 bytes
#define SVC_SVC_YM_STRUCT_T 0x3401010
//SVC_SVC_YM_STRUCT_T size: 996 bytes
#define SVC_LO_LP_SOS1_B0 0x3401024
#define SVC_LO_LP_SOS1_B1 0x3401028
#define SVC_LO_LP_SOS1_B2 0x340102C
#define SVC_LO_LP_SOS1_A1 0x3401030
#define SVC_LO_LP_SOS1_A2 0x3401034
#define SVC_LO_LP_SOS2_B0 0x3401038
#define SVC_LO_LP_SOS2_B1 0x340103C
#define SVC_LO_LP_SOS2_B2 0x3401040
#define SVC_LO_LP_SOS2_A1 0x3401044
#define SVC_LO_LP_SOS2_A2 0x3401048
#define SVC_LO_LP_SOS3_B0 0x340104C
#define SVC_LO_LP_SOS3_B1 0x3401050
#define SVC_LO_LP_SOS3_B2 0x3401054
#define SVC_LO_LP_SOS3_A1 0x3401058
#define SVC_LO_LP_SOS3_A2 0x340105C
#define SVC_LO_HP_SOS1_B0 0x3401060
#define SVC_LO_HP_SOS1_B1 0x3401064
#define SVC_LO_HP_SOS1_B2 0x3401068
#define SVC_LO_HP_SOS1_A1 0x340106C
#define SVC_LO_HP_SOS1_A2 0x3401070
#define SVC_HI_BP_SOS1_B0 0x3401074
#define SVC_HI_BP_SOS1_B1 0x3401078
#define SVC_HI_BP_SOS1_B2 0x340107C
#define SVC_HI_BP_SOS1_A1 0x3401080
#define SVC_HI_BP_SOS1_A2 0x3401084
#define SVC_HI_BP_SOS2_B0 0x3401088
#define SVC_HI_BP_SOS2_B1 0x340108C
#define SVC_HI_BP_SOS2_B2 0x3401090
#define SVC_HI_BP_SOS2_A1 0x3401094
#define SVC_HI_BP_SOS2_A2 0x3401098
#define SVC_HI_BP_SOS3_B0 0x340109C
#define SVC_HI_BP_SOS3_B1 0x34010A0
#define SVC_HI_BP_SOS3_B2 0x34010A4
#define SVC_HI_BP_SOS3_A1 0x34010A8
#define SVC_HI_BP_SOS3_A2 0x34010AC
#define SVC_HI_BP_SOS4_B0 0x34010B0
#define SVC_HI_BP_SOS4_B1 0x34010B4
#define SVC_HI_BP_SOS4_B2 0x34010B8
#define SVC_HI_BP_SOS4_A1 0x34010BC
#define SVC_HI_BP_SOS4_A2 0x34010C0
#define SVC_V_GAIN 0x34010C4
#define SVC_I_GAIN 0x34010C8
#define SVC_LO_V_GAIN 0x34010CC
#define SVC_LO_I_GAIN 0x34010D0
#define SVC_LO_DI_GAIN 0x34010D4
#define SVC_HI_V_GAIN 0x34010D8
#define SVC_HI_I_GAIN 0x34010DC
#define SVC_HI_DI_GAIN 0x34010E0
#define SVC_LO_DEN_MSB_THR 0x34010E4
#define SVC_HI_DEN_MSB_THR 0x34010E8
#define SVC_SW_EST_CONTROLS_HW 0x34010EC
#define SVC_REFLVL_CTRL 0x34010F0
#define SVC_RE_SF 0x34010F4
#define SVC_RE_HI_SF 0x34010F8
#define SVC_RE_LO_SF 0x34010FC
#define SVC_RE_INV_SF 0x3401100
#define SVC_RE_LO_STATUS 0x3401108
#define SVC_RE_HI_STATUS 0x340110C
#define SVC_RE_EST_STATUS 0x3401110
#define SVC_VMON_OFFSET_STATUS 0x3401114
#define SVC_IMON_OFFSET_STATUS 0x3401118
#define SVC_RE_INIT_STATUS 0x340111C
#define SVC_LE_EST_STATUS 0x3401120
#define SVC_ERROR_STATUS 0x3401124
#define SVC_OL2CL_RAMP_FRAMES 0x340115C
#define SVC_OL2CL_RAMP_START_DELAY 0x3401160
#define SVC_OL2CL_RAMP_MAX_MANTISSA 0x3401164
#define SVC_LE_EST_PILOT_HI_PERIOD_SMP 0x3401168
#define SVC_LE_EST_PILOT_HI_LEVEL 0x340116C
#define SVC_LE_EST_PILOT_HI_START_SMP 0x3401170
#define SVC_LE_EST_OFST_CAL_NSMP 0x3401174
#define SVC_LE_EST_OFST_CAL_START_SMP 0x3401178
#define SVC_LE_CANCEL_SF 0x3401218
#define SVC_ID_ACPOW_COEFF 0x3401228
#define SVC_ID_DCNOTCH_COEF 0x340122C
#define SVC_ID_HAP_DLY 0x3401234
#define SVC_ID_ENABLE 0x3401238
#define SVC_ID_VMONPOW 0x340123C
#define SVC_ID_HMONPOW 0x3401240
#define SVC_ID_HINPOW 0x3401244
#define SVC_ID_FRECP 0x3401248
#define SVC_ID_VP_COEF 0x340124C
#define SVC_ID_HP_COEF 0x3401250
#define SVC_ID_FRECPTHR 0x3401254
#define SVC_ID_UNSTABLE_FLAG 0x3401258
#define SVC_ID_STABLE_TH 0x340125C
#define SVC_ID_UNSTABLE_TH 0x3401260
#define SVC_ID_ANGLEMETRIC_COEFF 0x3401264
#define SVC_ID_RE_SAFE_VAL 0x3401268
#define SVC_ID_CONTROL_ENABLE 0x340126C
#define SVC_ID_VALID_POW_TH 0x3401270
#define SVC_ID_SVC_SHUTDOWN_VAL 0x3401274
#define SVC_ID_SVC_SHUTDOWN_STATE 0x3401278
#define SVC_ID_SHUTDOWN_COEFF 0x340127C
#define SVC_ID_SVC_SHUTDOWN 0x3401280
#define SVC_ID_SVC_SHUTDOWN_RESET 0x3401284
#define SVC_ID_SVC_SHUTDOWN_TH 0x3401288
#define SVC_ID_LOCKCOUNT_INIT 0x340128C
#define SVC_ID_EVENT_LOCKCOUNT 0x3401290
#define SVC_ID_HMONOFF_THR 0x3401294
#define SVC_ID_VMONOK_THR 0x3401298
#define SVC_ID_HMONOFF_FLAG 0x340129C
#define SVC_HW_SER_R_CTRL 0x34012C8
#define SVC_HW_SER_L_CTRL 0x34012CC
#define SVC_INIT_PH_PILOT_HI_PERIOD_SMP 0x34012EC
#define SVC_INIT_PH_PILOT_HI_LEVEL 0x34012F0
#define SVC_INIT_PH_PILOT_HI_START_SMP 0x34012F4
#define SVC_INIT_PH_OFST_CAL_NSMP 0x34012F8
#define SVC_INIT_PH_OFST_CAL_INVERSE_NSMP 0x34012FC
#define SVC_INIT_PH_OFST_CAL_START_SMP 0x3401300
#define SVC_INIT_PH_OFST_STL_NSMP 0x3401304
#define SVC_RE_MIN 0x3401308
#define SVC_RE_MAX 0x340130C
#define SVC_SWITCH_R_LPF_BW_SMP 0x340131C
#define SVC_R_LPF_BW_SEL_HIGH 0x3401320
#define SVC_R_LPF_BW_SEL_LOW 0x3401324
#define SVC_PBK_PH_PILOT_LO_PERIOD_SMP 0x340133C
#define SVC_PBK_PH_PILOT_LO_LEVEL 0x3401340
#define SVC_PBK_PH_PILOT_LO_START_SMP 0x3401344
#define SVC_PBK_PH_ACQ_RL_EST_LO_ACC_START_SMP 0x3401350
#define SVC_PBK_PH_ACQ_RL_EST_LO_LSFIT_NUM 0x3401354
#define SVC_PBK_PH_ACQ_RL_EL_LO_LSFIT_INCRN_SMP 0x3401364
#define SVC_PBK_PH_TRK_RL_EL_LO_LSFIT_INCRN_SMP 0x3401368
#define SVC_PBK_PH_ACQ_RL_EL_LO_LSFIT_INCR1_SMP 0x340136C
#define SVC_PBK_PH_PILOT_LO_LEVEL_CL2OL 0x34013C8
#define SVC_FORCE_RE_INIT_WHEN_NO_HIBERNATE 0x34013D0
#define SVC_IMON_OFFSET_OTP_VAL 0x34013D4
#define SVC_HW_SVC_CTRL 0x34013D8
#define SVC_HW_SVC_FILT_CFG 0x34013DC
#define SVC_HW_SVC_GAIN 0x34013E0
#define SVC_VIMON_SAMPLING_PERIOD 0x34013E4
#define SVC_RE_HI_LO_IMON_THRESHOLD 0x34013E8
#define SVC_LO_V_DELAY 0x34013EC
#define SVC_LO_I_DELAY 0x34013F0

//Definitions for VIBEGEN Controls
#define VIBEGEN_EGEN_XM_STRUCT_T 0x2805C00
//VIBEGEN_EGEN_XM_STRUCT_T size: 8072 bytes
#define VIBEGEN_F0_OTP_STORED 0x2805C00
#define VIBEGEN_REDC_OTP_STORED 0x2805C04
#define VIBEGEN_F0_OFFSET 0x2805C08
#define VIBEGEN_TIMEOUT_MS 0x2805C0C
#define VIBEGEN_TRIGGER_WAVE_INDEX 0x2805C10
#define VIBEGEN_END_PLAYBACK 0x2805C14
#define VIBEGEN_NUM_OF_WAVES 0x2805C18
#define VIBEGEN_WAVE_TYPE 0x2805C1C
#define VIBEGEN_PLAY_STATE 0x2805C20
#define VIBEGEN_EVENT_COUNT 0x2805C24
#define VIBEGEN_Q_STORED 0x2805C28
#define VIBEGEN_P_VIBEGEN_ROM 0x2805C2C
#define VIBEGEN_COMPENSATION_ENABLE 0x2805C30
#define VIBEGEN_OWT_BASE_XM 0x2805C34
#define VIBEGEN_OWT_SIZE_XM 0x2805C38
#define VIBEGEN_OWT_NEXT_XM 0x2805C3C
#define VIBEGEN_OWT_NUM_OF_WAVES_XM 0x2805C40
#define VIBEGEN_PWLE_EXTEND_ZERO_CROSS 0x2805C44
#define VIBEGEN_WAVE_XM_TABLE 0x2805C48
//VIBEGEN_WAVE_XM_TABLE size: 8000 bytes
#define VIBEGEN_EGEN_YM_STRUCT_T 0x3403000
//VIBEGEN_EGEN_YM_STRUCT_T size: 8000 bytes
#define VIBEGEN_WAVE_YM_TABLE 0x3403000
//VIBEGEN_WAVE_YM_TABLE size: 8000 bytes

/** @} */

/**
 * Total blocks of CS40L53 Firmware
 */
#define cs40l53_total_fw_blocks (9)

/**
 * Total blocks of CS40L53 Coefficient _0 data
 */
#define cs40l53_total_coeff_blocks_0 (5)


/***********************************************************************************************************************
 * MACROS
 **********************************************************************************************************************/

/***********************************************************************************************************************
 * ENUMS, STRUCTS, UNIONS, TYPEDEFS
 **********************************************************************************************************************/
/**
 * Block of HALO P/X/Y Memory contents for either firmware or coefficient download.
 */
#ifndef HALO_BOOT_BLOCK_T_DEFINED
#define HALO_BOOT_BLOCK_T_DEFINED
typedef struct
{
    uint32_t block_size;    ///< Size of block in bytes
    uint32_t address;       ///< Control Port register address at which to begin loading
    const uint8_t *bytes;   ///< Pointer to array of bytes consisting of block payload
} halo_boot_block_t;
#endif

/***********************************************************************************************************************
 * GLOBAL VARIABLES
 **********************************************************************************************************************/

/**
 * Firmware memory block metadata
 */
extern const halo_boot_block_t cs40l53_fw_blocks[];

/**
 * Coefficient _0 memory block metadata
 */
extern const halo_boot_block_t cs40l53_coeff_0_blocks[];


/***********************************************************************************************************************
 * API FUNCTIONS
 **********************************************************************************************************************/

/**********************************************************************************************************************/

#endif // CS40L53_FIRMWARE_H
```
