## CMakeLists.txt
```
# SPDX-License-Identifier: Apache-2.0

cmake_minimum_required(VERSION 3.20.0)

find_package(Zephyr REQUIRED HINTS $ENV{ZEPHYR_BASE})
project(cs40l50)

FILE(GLOB app_sources src/*.c ../../cs40l50/*.c ../../common/fw_img.c)
target_sources(app PRIVATE ${app_sources})

zephyr_library_add_dependencies(offsets_h)

zephyr_compile_definitions(CIRRUS_ZEPHYR_SAMPLE)

add_subdirectory(src)
```

## prj.conf
```kconfig
CONFIG_LOG=y
CONFIG_HAPTICS=y
CONFIG_HAPTICS_CS40L50=y
CONFIG_HEAP_MEM_POOL_SIZE=8192
```

## src/main.c
```c
/*
 * Copyright (c) 2024 Cirrus Logic, Inc.
 *
 * SPDX-License-Identifier: Apache-2.0
 */

#include <errno.h>

#include <zephyr/device.h>
#include <zephyr/devicetree.h>
#include <zephyr/kernel.h>
#include <zephyr/logging/log.h>
#include <zephyr/drivers/haptics.h>
#include <zephyr/drivers/i2c.h>
//#include "drivers/haptics/cs40l50.h"
#include <zephyr/drivers/uart.h>
#include <zephyr/sys/util.h>
#include <sys/_stdint.h>

#define LOG_LEVEL 4

#include "cs40l50_bsp.h"

LOG_MODULE_REGISTER(main);

int main(void)
{
        int ret;
        char in_char;
        const struct device *dev1 = DEVICE_DT_GET(DT_NODELABEL(haptic1));
        const struct device *uart = DEVICE_DT_GET(DT_NODELABEL(usart2));
        struct cs40l50_haptic_source_config hap_cfg = {
                .index = 23,
                .bank = 0, //ROM
        };

        if (!dev1) {
                LOG_ERR("CS40L50 device not found");
                return -ENODEV;
        } else if (!device_is_ready(dev1)) {
                LOG_ERR("CS40L50 device %s is not ready", dev1->name);
                //return -EIO;
        } else {
                LOG_INF("Found CS40L50 device %s", dev1->name);
        }

        while (1) {

                ret = uart_poll_in(uart, &in_char);

                if (ret == 0) {
                        ret = haptics_start_output(dev1);
                        if (ret < 0) {
                                LOG_ERR("Failed to start output: %d", ret);
                                return ret;
                        }
                }
                k_msleep(1);
        }

        return 0;
}
```

## src/cs40l50_bsp.c
```c
/*
 * Copyright (c) Cirrus Logic 2022-2025 All Rights Reserved, http://www.cirrus.com/
 *
 * Licensed under the Apache License, Version 2.0 (the License); you may
 * not use this file except in compliance with the License.
 * You may obtain a copy of the License at
 *
 * www.apache.org/licenses/LICENSE-2.0
 *
 * Unless required by applicable law or agreed to in writing, software
 * distributed under the License is distributed on an AS IS BASIS, WITHOUT
 * WARRANTIES OR CONDITIONS OF ANY KIND, either express or implied.
 * See the License for the specific language governing permissions and
 * limitations under the License.
 *
 */

#include "cs40l50_bsp.h"
#include "cs40l50.h"
#include <zephyr/kernel.h>
#include <zephyr/logging/log.h>
#include <zephyr/drivers/i2c.h>

#include "cs40l50_firmware.h"

LOG_MODULE_REGISTER(cirrus_cs40l50);

struct cs40l50_config {
    struct i2c_dt_spec i2c;
    struct gpio_dt_spec reset_gpio;
    void (*irq_cfg_func)(void);
    void (*irq_enable_func)(void);
    void (*irq_disable_func)(void);
};

struct cs40l50_bsp {
    cs40l50_t priv;
    struct cs40l50_haptic_source_config hap_cfg;
};

int cs40l50_i2c_write_reg_dt(const struct i2c_dt_spec *spec, const uint32_t reg_addr,
                    const uint32_t value)
{
    uint8_t addr_buf[4], data_buf[4], msg_buf[8];
    int i, j = 4;

    sys_put_be32(reg_addr, addr_buf);
    sys_put_be32(value, data_buf);

    for (i = 0; i < ARRAY_SIZE(addr_buf); i++) {
        msg_buf[i] = addr_buf[i];
        msg_buf[j] = data_buf[i];
        j++;
    }

    return i2c_write_dt(spec, msg_buf, sizeof(msg_buf));
}

int cs40l50_i2c_read_reg_dt(const struct i2c_dt_spec *spec, const uint32_t reg_addr,
                   uint32_t *value)
{
    uint8_t write_buf[4], read_buf[4];
    int ret;

    sys_put_be32(reg_addr, write_buf);

    ret = i2c_write_read_dt(spec, write_buf, sizeof(write_buf), read_buf, sizeof(read_buf));
    if (ret < 0) {
        LOG_INF("cs40l50_i2c_read_reg_dt error\n");
        return ret;
    }

    *value = sys_get_be32(read_buf);

    return 0;
}

int cs40l50_update_reg_dt(const struct i2c_dt_spec *spec, const uint32_t reg_addr,
                 const uint32_t mask, const uint32_t value)
{
    uint32_t old_value, new_value;
    int ret;

    ret = cs40l50_i2c_read_reg_dt(spec, reg_addr, &old_value);
    if (ret < 0) {
        return ret;
    }

    new_value = (old_value & ~mask) | (value & mask);
    if (new_value == old_value) {
        return 0;
    }

    return cs40l50_i2c_write_reg_dt(spec, reg_addr, new_value);
}

/* write addr/word pairs */
int cs40l50_write_array_dt(const struct i2c_dt_spec *spec,
                    const uint32_t *array, uint32_t words)
{
    int i, ret;

    for (i = 0; i < words; i+=2) {
        ret = cs40l50_i2c_write_reg_dt(spec, array[i], array[i+1]);
        if (ret < 0) {
            return ret;
        }
    }
    return 0;
}

/**
 * Reads a register for a specific value for a specified amount of tries while waiting between reads.
 *
 */
int cs40l50_poll_reg_dt(const struct i2c_dt_spec *spec, const uint32_t reg_addr,
                   uint32_t value, uint32_t tries, uint32_t delay)
{
    uint32_t tmp;
    int i, ret;

    for (i = 0; i < tries; i++) {
        ret = cs40l50_i2c_read_reg_dt(spec, reg_addr, &tmp);
        if (ret < 0) {
            return ret;
        }

        if (tmp == value)
          return 0;

        k_msleep(delay);
    }
    return 0;
}

int cs40l50_write_acked_reg_dt(const struct i2c_dt_spec *spec, const uint32_t reg_addr,
                                uint32_t val, uint32_t acked_val,  uint8_t tries,  uint32_t delay)
{
    int i, ret;

    ret = cs40l50_i2c_write_reg_dt(spec, reg_addr, val);
    if (ret < 0) {
        return ret;
    }

    for (i = 0 ; i < tries; i++) {
        uint32_t temp_reg_val;

        k_msleep(delay);

        cs40l50_i2c_read_reg_dt(spec, reg_addr, &temp_reg_val);

        if (temp_reg_val == acked_val)
        {
            return 0;
        }
    }

    return -1;
}

int cs40l50_i2c_write_bulk_bus(const struct i2c_dt_spec *spec, const uint32_t reg_addr,
    const uint8_t *buf, unsigned int num_bytes, uint16_t bus_addr)
{
    uint8_t addr_buf[4], *msg_buf;
    int i, j = 4, ret = 0;

    LOG_INF("cs40l50_i2c_write_bulk_bus: reg=%x size=%d\n", reg_addr, num_bytes);

    msg_buf = k_malloc(num_bytes+4);
    if (!msg_buf)
        return -ENOMEM;

    sys_put_be32(reg_addr, addr_buf);

    for (i = 0; i < ARRAY_SIZE(addr_buf); i++) {
        msg_buf[i] = addr_buf[i];
    }

    bytecpy(msg_buf+4, buf, num_bytes);

    ret = i2c_write(spec->bus, msg_buf, 4 + num_bytes, bus_addr);

    k_free(msg_buf);
    return ret;
}

int cs40l50_i2c_write_bus(const struct i2c_dt_spec *spec, const uint32_t reg_addr,
    uint32_t val, uint16_t bus_addr)
{
    uint8_t addr_buf[4], data_buf[4], *msg_buf;
    int i, j = 4, ret = 0;

    LOG_INF("cs40l50_i2c_write_bus: reg=%x\n", reg_addr);

    msg_buf = k_malloc(8);
    if (!msg_buf)
        return -ENOMEM;

    sys_put_be32(reg_addr, addr_buf);
    sys_put_be32(val, data_buf);

    bytecpy(msg_buf, addr_buf, 4);
    bytecpy(msg_buf+4, data_buf, 4);

    ret = i2c_write(spec->bus, msg_buf, 8, bus_addr);

    k_free(msg_buf);
    return ret;
}

int cs40l50_i2c_write_bulk_dt(const struct i2c_dt_spec *spec, const uint32_t reg_addr,
    const uint8_t *buf, unsigned int num_bytes)
{
    uint8_t addr_buf[4], *msg_buf;
    int i, j = 4, ret = 0;

    LOG_INF("cs40l50_i2c_write_bulk_dt: reg=%x size=%d\n", reg_addr, num_bytes);

    msg_buf = k_malloc(num_bytes+4);
    if (!msg_buf)
        return -ENOMEM;

    sys_put_be32(reg_addr, addr_buf);

    for (i = 0; i < ARRAY_SIZE(addr_buf); i++) {
        msg_buf[i] = addr_buf[i];
    }

    bytecpy(msg_buf+4, buf, num_bytes);

    ret = i2c_write_dt(spec, msg_buf, sizeof(msg_buf) + num_bytes);

    k_free(msg_buf);
    return ret;
}

static int cs40l50_write_fw_blocks(struct i2c_dt_spec *i2c, halo_boot_block_t *blocks, int num_blocks)
{
    int i, ret;
    halo_boot_block_t block;
    uint32_t *buffer, bytes, address;

    for (i = 0; i < num_blocks; i++) {
        block = blocks[i];
        bytes = block.block_size;
        address = block.address;
        buffer = block.bytes;
        ret = cs40l50_i2c_write_bulk_dt(i2c, address, buffer, bytes);
        if (ret != 0)
            return ret;
        k_msleep(5);
    }

    return 0;
}

static int cs40l50_gpi_get_level(cs40l50_t *drv, unsigned int gpio)
{
    uint32_t gpio_status, eint;
    struct i2c_dt_spec *i2c = drv->config.bsp_config.i2c;

    if (gpio > 13)
        return -1;

    regmap_read(i2c, CS40L50_GPIO_STATUS1, &gpio_status);

    return ((gpio_status & (1 << (gpio - 1))) != 0);
}

enum cs40l50_tuning_set {
    CS40L50_TUNING_SET_A,
    CS40L50_TUNING_SET_B,
};

static unsigned int get_tuning_set(cs40l50_t *drv)
{
    struct i2c_dt_spec *i2c = drv->config.bsp_config.i2c;
    int gpi_level;

    gpi_level = cs40l50_gpi_get_level(drv, 1);
    return gpi_level;
}

static int cs40l50_firmware_load(cs40l50_t *drv)
{
    int i, num_blocks, ret;
    halo_boot_block_t *blocks;
    struct i2c_dt_spec *i2c = drv->config.bsp_config.i2c;
    uint32_t tuning_set;

    tuning_set = get_tuning_set(drv);

    num_blocks = cs40l50_total_fw_blocks;
    blocks = cs40l50_fw_blocks;
    ret = cs40l50_write_fw_blocks(i2c, blocks, num_blocks);
    if (ret != 0)
        return ret;

    if (tuning_set == CS40L50_TUNING_SET_A) {
        num_blocks = cs40l50_SVC_A_total_coeff_blocks_0;
        blocks = cs40l50_SVC_A_coeff_0_blocks;
        ret = cs40l50_write_fw_blocks(i2c, blocks, num_blocks);
        if (ret != 0)
            return ret;

        num_blocks = cs40l50_WT_A_total_coeff_blocks_2;
        blocks = cs40l50_WT_A_coeff_2_blocks;
        ret = cs40l50_write_fw_blocks(i2c, blocks, num_blocks);
        if (ret != 0)
            return ret;

        LOG_INF("Loaded tuning set A");
    } else if (tuning_set == CS40L50_TUNING_SET_B) {
        num_blocks = cs40l50_SVC_B_total_coeff_blocks_1;
        blocks = cs40l50_SVC_A_coeff_0_blocks;
        ret = cs40l50_write_fw_blocks(i2c, blocks, num_blocks);
        if (ret != 0)
            return ret;

        num_blocks = cs40l50_WT_B_total_coeff_blocks_3;
        blocks = cs40l50_WT_B_coeff_3_blocks;
        ret = cs40l50_write_fw_blocks(i2c, blocks, num_blocks);
        if (ret != 0)
            return ret;

        LOG_INF("Loaded tuning set B");
    }

    return 0;
}

static int cs40l50_clear_gpio_triggers(cs40l50_t *drv)
{
    int i;
    struct i2c_dt_spec *i2c = drv->config.bsp_config.i2c;

    for (i = 0; i < 16; i++)
        regmap_write(i2c, CS40L50_GPIO_HANDLERS_BASE + i*4, 0x1FF);

    return 0;
}

static int cs40l50_setup_gpi(cs40l50_t *drv, unsigned int gpio)
{
    struct i2c_dt_spec *i2c = drv->config.bsp_config.i2c;

    if (gpio > 13)
        return -1;

    regmap_write(i2c, CS40L50_GPIO_CTRL1 + (4 * (gpio - 1)),
        CS40L50_GPIO_CTRL_DIR_BITMASK | CS40L50_GPIO_CTRL_FN_INPUT_OUTPUT);
}

static uint32_t cs40l50_set_timer(uint32_t duration_ms, bsp_callback_t cb, void *cb_arg)
{
    k_msleep(duration_ms);
    return 0;
}

static uint32_t cs40l50_register_gpio_cb(uint32_t gpio_id, bsp_callback_t cb, void *cb_arg)
{
    //TODO
    return 0;
}

static uint32_t cs40l50_set_gpio(uint32_t gpio_id, uint8_t gpio_state)
{
    //TODO
    return 0;
}

bsp_driver_if_t cs40l50_bsp_driver_if = {
    .set_timer = cs40l50_set_timer,
    .register_gpio_cb = cs40l50_register_gpio_cb,
    .set_gpio = cs40l50_set_gpio
};

bsp_driver_if_t *bsp_driver_if_g = &cs40l50_bsp_driver_if;

/* ===================================================================================== */

static int cs40l50_init(const struct device *dev)
{
    struct cs40l50_config *config = dev->config;
    struct cs40l50_bsp *data = dev->data;
    cs40l50_t *drv = &data->priv;
    uint32_t val;
    int ret;
    LOG_INF("cs40l50_init\n");

    drv->config.bsp_config.i2c = &config->i2c;
    drv->config.syscfg_regs = cs40l50_syscfg_regs;
    drv->config.syscfg_regs_total = CS40L50_SYSCFG_REGS_TOTAL;
    drv->config.is_ext_bst = true;

    if (!i2c_is_ready_dt(&config->i2c)) {
        LOG_INF("cs40l50 no I2C\n");
        return -ENODEV;
    }

    ret = cs40l50_reset(drv);
    if (ret < 0) {
        return ret;
    }

    k_msleep(1000);

    regmap_read(&config->i2c, FIRMWARE_CS40L50_HALO_STATE, &val);
    LOG_INF("cs40l50_init: HALO_STATE = %x\n", val);

    LOG_INF("cs40l50_calibrate\n");
    ret = cs40l50_calibrate(drv);
    if (ret < 0) {
        LOG_INF("cs40l50_calibrate error\n");
        return ret;
    }

    ret = cs40l50_boot(drv, NULL);
    if (ret < 0) {
        LOG_INF("cs40l50_boot error\n");
        return ret;
    }

    cs40l50_setup_gpi(drv, 1);

    LOG_INF("cs40l50_firmware_load\n");
    ret = cs40l50_firmware_load(drv);
    if (ret < 0) {
        LOG_INF("cs40l50_firmware_load error\n");
        return ret;
    }

    ret = regmap_write(&config->i2c, CS40L50_DSP1_CCM_CORE_CONTROL, 0x00000281);
    if (ret < 0) {
        LOG_INF("cs40l50_boot error\n");
        return ret;
    }

    cs40l50_clear_gpio_triggers(drv);

    k_msleep(1000);

    /* to-do */
    regmap_read(&config->i2c, FIRMWARE_CS40L50_HALO_STATE, &val);
    LOG_INF("cs40l50_init: HALO_STATE = %x\n", val);

//    config->irq_cfg_func();
//    config->irq_enable_func();

    return 0;
}

static int haptics_cs40l50_stop_output(const struct device *dev)
{
    return 0;
}

static int haptics_cs40l50_start_output(const struct device *dev)
{
    struct cs40l50_bsp *data = dev->data;

    LOG_INF("haptics_cs40l50_start_output, bank=%x, index=%x\n", data->hap_cfg.bank, data->hap_cfg.index);

    cs40l50_trigger(&data->priv, data->hap_cfg.index, RAM_BANK);

    return 0;
}

static const struct haptics_driver_api cs40l50_driver_api = {
    .start_output = &haptics_cs40l50_start_output,
    .stop_output = &haptics_cs40l50_stop_output,
};

static void cs40l50_isr(void *arg)
{
}

#define CS40L50_INIT(inst)                                                                         \
                                                                                                   \
                                                                                                   \
    static const struct cs40l50_config cs40l50_config_##inst = {                               \
        .i2c = I2C_DT_SPEC_INST_GET(inst),                                                 \
    };                                                                                         \
                                                                                                   \
    static struct cs40l50_bsp cs40l50_bsp_data_##inst = {                                         \
                                                                                                   \
    };                                                                                         \
                                                                                                   \
    PM_DEVICE_DT_INST_DEFINE(inst, cs40l50_pm_action);                                         \
                                                                                                   \
    DEVICE_DT_INST_DEFINE(inst, &cs40l50_init, NULL, &cs40l50_bsp_data_##inst,                     \
                  &cs40l50_config_##inst, POST_KERNEL, CONFIG_HAPTICS_INIT_PRIORITY,   \
                  &cs40l50_driver_api);

DT_INST_FOREACH_STATUS_OKAY(CS40L50_INIT)

/* ===================================================================================== */
```

## src/cs40l50_bsp.h
```c
/*
 * Copyright (c) 2024 Cirrus Logic, Inc.
 * SPDX-License-Identifier: Apache-2.0
 */

#ifndef CS40L50_BSP_H
#define CS40L50_BSP_H

#define DT_DRV_COMPAT cirrus_cs40l50

#include "cs40l50.h"
#include <stdbool.h>

#include <zephyr/sys/byteorder.h>
#include <zephyr/device.h>
#include <zephyr/pm/device.h>
#include <zephyr/pm/device_runtime.h>
#include <zephyr/devicetree.h>
#include <zephyr/drivers/gpio.h>
#include <zephyr/drivers/haptics.h>
#include <zephyr/irq.h>
#include <zephyr/kernel.h>
#include <zephyr/logging/log.h>
#include <zephyr/sys/util.h>

#include "cs40l50.h"

#define regmap_cp_config_t struct i2c_dt_spec
#define REGMAP_GET_CP(x) x->config.bsp_config.i2c
#define regmap_read cs40l50_i2c_read_reg_dt
#define regmap_write cs40l50_i2c_write_reg_dt
#define regmap_update_reg cs40l50_update_reg_dt
#define regmap_write_array cs40l50_write_array_dt
#define regmap_poll_reg cs40l50_poll_reg_dt
#define regmap_write_acked_reg cs40l50_write_acked_reg_dt
#define regmap_write_blocks cs40l50_i2c_write_bulk_dt

/***********************************************************************************************************************
 * LITERALS & CONSTANTS
 **********************************************************************************************************************/

/**
 * @defgroup BSP_STATUS_
 * @brief Return values for all public and most private API calls
 *
 * @{
 */
#define BSP_STATUS_OK               (0)
#define BSP_STATUS_FAIL             (1)
/** @} */

/**
 * @defgroup BSP_TIMER_DURATION_
 * @brief Values used for calls to BSP timer APIs
 *
 * @see bsp_driver_if_t.set_timer
 *
 * @{
 */
#define BSP_TIMER_DURATION_1MS      (1)
#define BSP_TIMER_DURATION_2MS      (2)
#define BSP_TIMER_DURATION_5MS      (5)
#define BSP_TIMER_DURATION_10MS     (10)
#define BSP_TIMER_DURATION_2S       (2000)
/** @} */

/**
 * Value to indicate driving a GPIO low
 *
 * @see bsp_driver_if_t.set_gpio
 *
 */
#define BSP_GPIO_LOW                (0)

/**
 * Value to indicate driving a GPIO high
 *
 * @see bsp_driver_if_t.set_gpio
 *
 */
#define BSP_GPIO_HIGH               (1)

/**
 * Value to indicate enabling or disabling a supply
 *
 * @see bsp_driver_if_t.set_supply
 *
 */
#define BSP_SUPPLY_DISABLE              (0)
#define BSP_SUPPLY_ENABLE               (1)


/***********************************************************************************************************************
 * MACROS
 **********************************************************************************************************************/

/**
 * Macro to extract byte from multi-byte word
 *
 * @param [in] A                multi-byte word
 * @param [in] B                zero-indexed byte position
 *
 * @return                      byte at position B in word A
 */
#define GET_BYTE_FROM_WORD(A, B)   ((A >> (B * 8)) & 0xFF)

/**
 * Macro to insert byte into multi-byte word
 *
 * @param [in, out] A           multi-byte word
 * @param [in] B                byte value
 * @param [in] C                zero-indexed byte position
 *
 * @return none
 */
#define ADD_BYTE_TO_WORD(A, B, C) \
{ \
    A &= (0xFFFFFF00 << (C * 8)); \
    A |= ((B & 0xFF) << (C * 8)); \
}

/***********************************************************************************************************************
 * ENUMS, STRUCTS, UNIONS, TYPEDEFS
 **********************************************************************************************************************/

/**
 * Callback type for BSP-to-Driver callbacks
 *
 * @param [in] status           Result of BSP call
 * @param [in] arg              Argument registered when BSP call was issued
 *
 * @return none
 *
 * @see BSP_STATUS_
 *
 */
typedef void (*bsp_callback_t)(uint32_t status, void* arg);

/**
 * BSP-to-Driver public API
 *
 * All API calls return a status @see CS35L41_STATUS_
 *
 */
typedef struct
{
    /**
     * Set GPIO to LOW/HIGH
     *
     * @param [in] gpio_id      ID for GPIO to change - can be defined in implementation header
     * @param [in] gpio_state   LOW or HIGH
     *
     * @return
     * - BSP_STATUS_FAIL        if gpio_id is invalid, or call to MCU HAL fails
     * - BSP_STATUS_OK          otherwise
     *
     * @see BSP_GPIO_LOW BSP_GPIO_HIGH
     *
     */
    uint32_t (*set_gpio)(uint32_t gpio_id, uint8_t gpio_state);

    /**
     * Enable or disable a supply
     *
     * @param [in] supply_id      ID for supply to change - can be defined in implementation header
     * @param [in] supply_state   Enable or Disable
     *
     * @return
     * - BSP_STATUS_FAIL        if gpio_id is invalid, or call to MCU HAL fails
     * - BSP_STATUS_OK          otherwise
     *
     * @note this function shouldn't return until the supply has finished rising or falling
     *
     * @see BSP_SUPPLY_ENABLE BSP_SUPPLY_DISABLE
     *
     */
    uint32_t (*set_supply)(uint32_t supply_id, uint8_t supply_state);

    /**
     * Register GPIO Callback
     *
     * Register a callback for when a GPIO changes state.
     *
     * @param [in] gpio_id      ID for GPIO to change - can be defined in implementation header
     * @param [in] cb           pointer to callback function
     * @param [in] cb_arg       pointer to argument to use when calling callback
     *
     * @return
     * - BSP_STATUS_FAIL        if gpio_id is invalid, if any pointers are NULL
     * - BSP_STATUS_OK          otherwise
     *
     */
    uint32_t (*register_gpio_cb)(uint32_t gpio_id, bsp_callback_t cb, void *cb_arg);

    /**
     * Set a timer to expire
     *
     * @param [in] duration_ms  Duration of timer in milliseconds
     * @param [in] cb           pointer to callback function
     * @param [in] cb_arg       pointer to argument to use when calling callback
     *
     * @return
     * - BSP_STATUS_FAIL        if duration_ms is invalid, if any pointers are NULL
     * - BSP_STATUS_OK          otherwise
     *
     */
    uint32_t (*set_timer)(uint32_t duration_ms, bsp_callback_t cb, void *cb_arg);

    /**
     * Reset I2C Port used for a specific device
     *
     * Abort the current I2C transaction and reset the I2C peripheral.  This is required for quickly handling of
     * CS35L41 IRQ events.
     *
     * @param [in] bsp_dev_id       ID of the I2C device corresponding to the I2C peripheral to reset
     * @param [out] was_i2c_busy    flag to indicate whether an I2C transaction was in progress when reset
     *
     * @return
     * - BSP_STATUS_FAIL        if bsp_dev_id is invalid
     * - BSP_STATUS_OK          otherwise
     *
     */
    uint32_t (*i2c_reset)(uint32_t bsp_dev_id, bool *was_i2c_busy);

    /**
     * Perform an I2C Write-Repeated Start-Read transaction
     *
     * This is the common way to read data from an I2C device with a register file, since the address of the
     * register to read must first be written to the device before reading any contents.
     *
     * Perform transaction in the order:
     * 1. I2C Start
     * 2. I2C write of \b write_length bytes from \b write_buffer
     * 3. I2C Repeated Start
     * 4. I2C read of \b read_length bytes into \b read_buffer
     * 5. I2C Stop
     *
     * BSP will decode \b bsp_dev_id to the correct I2C bus and I2C address.
     *
     * @param [in] bsp_dev_id       ID of the I2C device corresponding to the I2C peripheral to reset
     * @param [in] write_buffer     pointer to array of bytes to write
     * @param [in] write_length     total number of bytes in \b write_buffer
     * @param [in] read_buffer      pointer to array of bytes to load with I2C bytes read
     * @param [in] read_length      total number of bytes to read into \b read_buffer
     * @param [in] cb               pointer to callback function
     * @param [in] cb_arg           pointer to argument to use when calling callback
     *
     * @return
     * - BSP_STATUS_FAIL            if bsp_dev_id is invalid, if any portion of I2C transaction failed
     * - BSP_STATUS_OK              otherwise
     *
     */
    uint32_t (*i2c_read_repeated_start)(uint32_t bsp_dev_id,
                                        uint8_t *write_buffer,
                                        uint32_t write_length,
                                        uint8_t *read_buffer,
                                        uint32_t read_length,
                                        bsp_callback_t cb,
                                        void *cb_arg);

    /**
     * Perform I2C Write
     *
     * BSP will decode \b bsp_dev_id to the correct I2C bus and I2C address.
     *
     * @param [in] bsp_dev_id       ID of the I2C device corresponding to the I2C peripheral to reset
     * @param [in] write_buffer     pointer to array of bytes to write
     * @param [in] write_length     total number of bytes in \b write_buffer
     * @param [in] cb               pointer to callback function
     * @param [in] cb_arg           pointer to argument to use when calling callback
     *
     * @return
     * - BSP_STATUS_FAIL            if bsp_dev_id is invalid, if any portion of I2C transaction failed
     * - BSP_STATUS_OK              otherwise
     *
     */
    uint32_t (*i2c_write)(uint32_t bsp_dev_id,
                          uint8_t *write_buffer,
                          uint32_t write_length,
                          bsp_callback_t cb,
                          void *cb_arg);

    /**
     * Perform a Double-Buffered ("db") I2C Write
     *
     * This will first write the contents of \b write_buffer_0 to the I2C device, and then write the contents of
     * \b write_buffer_1.
     *
     * @param [in] bsp_dev_id       ID of the I2C device corresponding to the I2C peripheral to reset
     * @param [in] write_buffer_0   pointer to array of first batch of bytes to write
     * @param [in] write_length_0   total number of bytes in \b write_buffer_0
     * @param [in] write_buffer_1   pointer to array of second batch of bytes to write
     * @param [in] write_length_1   total number of bytes in \b write_buffer_1
     * @param [in] cb               pointer to callback function
     * @param [in] cb_arg           pointer to argument to use when calling callback
     *
     * @return
     * - BSP_STATUS_FAIL            if bsp_dev_id is invalid, if any portion of I2C transaction failed
     * - BSP_STATUS_OK              otherwise
     *
     */
    uint32_t (*i2c_db_write)(uint32_t bsp_dev_id,
                          uint8_t *write_buffer_0,
                          uint32_t write_length_0,
                          uint8_t *write_buffer_1,
                          uint32_t write_length_1,
                          bsp_callback_t cb,
                          void *cb_arg);

    /**
     * Perform a SPI read
     *
     * This function will write and then read back data from a SPI device with a register file. Padding
     * will automatically be added.
     *
     * Perform transaction in the order:
     * 1. SPI CS low
     * 2. SPI write of \b addr_length bytes from \b addr_buffer
     * 3. SPI write of pad_len padding clock cycles
     * 4. SPI read of \b data_length bytes into \b data_buffer
     * 5. SPI CS high
     *
     * BSP will decode \b bsp_dev_id to the correct SPI bus and SPI address.
     *
     * @param [in] bsp_dev_id       ID of the SPI device corresponding to the SPI peripheral to reset
     * @param [in] addr_buffer      pointer to array of bytes to write
     * @param [in] addr_length      total number of bytes in \b write_buffer
     * @param [in] data_buffer      pointer to array of bytes to load with SPI bytes read
     * @param [in] data_length      total number of bytes to read into \b read_buffer
     * @param [in] pad_len          total number of bytes of padding between the addr write transaction and the data read
     *
     * @return
     * - BSP_STATUS_FAIL            if bsp_dev_id is invalid, if any portion of SPI transaction failed
     * - BSP_STATUS_OK              otherwise
     *
     */
    uint32_t (*spi_read)(uint32_t bsp_dev_id,
                         uint8_t *addr_buffer,
                         uint32_t addr_length,
                         uint8_t *data_buffer,
                         uint32_t data_length,
                         uint32_t pad_len);

    /**
     * Perform a SPI write
     *
     * This function will write data to a SPI device with a register file. Padding will automatically
     * be added.
     *
     * Perform transaction in the order:
     * 1. SPI CS low
     * 2. SPI write of \b addr_length bytes from \b addr_buffer
     * 3. SPI write of pad_len padding clock cycles
     * 4. SPI write of \b data_length bytes into \b data_buffer
     * 5. SPI CS high
     *
     * BSP will decode \b bsp_dev_id to the correct SPI bus and SPI address.
     *
     * @param [in] bsp_dev_id       ID of the SPI device corresponding to the SPI peripheral to reset
     * @param [in] addr_buffer      pointer to array of bytes to write
     * @param [in] addr_length      total number of bytes in \b write_buffer
     * @param [in] data_buffer      pointer to array of bytes to load with SPI bytes read
     * @param [in] data_length      total number of bytes to read into \b read_buffer
     * @param [in] pad_len          total number of bytes of padding between the addr write transaction and the data write
     *
     * @return
     * - BSP_STATUS_FAIL            if bsp_dev_id is invalid, if any portion of SPI transaction failed
     * - BSP_STATUS_OK              otherwise
     *
     */
    uint32_t (*spi_write)(uint32_t bsp_dev_id,
                          uint8_t *addr_buffer,
                          uint32_t addr_length,
                          uint8_t *data_buffer,
                          uint32_t data_length,
                          uint32_t pad_len);

    /**
     * Global enable of interrupts
     *
     * Since this is MCU-platform specific, it is included as part of the BSP-Driver interface.
     *
     * @return
     * - BSP_STATUS_FAIL            if bsp_dev_id is invalid, if any portion of I2C transaction failed
     * - BSP_STATUS_OK              otherwise
     *
     */
    uint32_t (*enable_irq)(void);

    /**
     * Global disable of interrupts
     *
     * Since this is MCU-platform specific, it is included as part of the BSP-Driver interface.
     *
     * @return
     * - BSP_STATUS_FAIL            if bsp_dev_id is invalid, if any portion of I2C transaction failed
     * - BSP_STATUS_OK              otherwise
     *
     */
    uint32_t (*disable_irq)(void);

    /**
     * Temporarily change the clock speed of the SPI bus
     *
     * Since portions of a driver may have a maximum bus speed limitation, this API allows for temporarily specifying
     * the maximum bus speed.
     *
     * @return
     * - BSP_STATUS_FAIL            if a slower speed is requested by the current SPI speed is already slowest available
     * - BSP_STATUS_OK              otherwise
     *
     */
    uint32_t (*spi_throttle_speed)(uint32_t speed_hz);

    /**
     * Restore the clock speed of the SPI bus to the original configuration
     *
     * After a call to spi_throttle_speed(), this API allows for restoring the bus clock speed of the SPI bus to the
     * original configuration given during BSP initialization.
     *
     * @return                      BSP_STATUS_OK always
     *
     */
    uint32_t (*spi_restore_speed)(void);
} bsp_driver_if_t;

enum cs40l50_haptic_rom_bank {
    CS40L50_HAPTIC_ROM_BUZZ_160,
    CS40L50_HAPTIC_ROM_CLICK_1,
    CS40L50_HAPTIC_ROM_CLICK_2,
    CS40L50_HAPTIC_ROM_CLICK_3,
    CS40L50_HAPTIC_ROM_CLICK_4,
    CS40L50_HAPTIC_ROM_CLICK_5,
    CS40L50_HAPTIC_ROM_CLICK_6,
    CS40L50_HAPTIC_ROM_CLICK_7,
    CS40L50_HAPTIC_ROM_CLICK_8,
    CS40L50_HAPTIC_ROM_BUZZ_240,
    CS40L50_HAPTIC_ROM_CLICK_1_VCM,
    CS40L50_HAPTIC_ROM_CLICK_2_VCM,
    CS40L50_HAPTIC_ROM_CLICK_3_VCM,
    CS40L50_HAPTIC_ROM_CLICK_4_VCM,
    CS40L50_HAPTIC_ROM_CLICK_5_VCM,
    CS40L50_HAPTIC_ROM_CLICK_6_VCM,
    CS40L50_HAPTIC_ROM_CLICK_7_VCM,
    CS40L50_HAPTIC_ROM_CLICK_8_VCM,
    CS40L50_HAPTIC_ROM_CLICK_9_VCM,
    CS40L50_HAPTIC_ROM_CLICK_10_VCM,
    CS40L50_HAPTIC_ROM_CLICK_11_VCM,
    CS40L50_HAPTIC_ROM_CLICK_12_VCM,
    CS40L50_HAPTIC_ROM_CLICK_13_VCM,
    CS40L50_HAPTIC_ROM_CLICK_14_VCM,
    CS40L50_HAPTIC_ROM_CLICK_15_VCM,
    CS40L50_HAPTIC_ROM_ZIPPER,
    CS40L50_HAPTIC_ROM_BUMP,
};

struct cs40l50_haptic_source_config {
    int index;
    int bank;
};

extern bsp_driver_if_t *bsp_driver_if_g;

int cs40l50_i2c_write_reg_dt(const struct i2c_dt_spec *spec, const uint32_t reg_addr,
                    const uint32_t value);
int cs40l50_i2c_read_reg_dt(const struct i2c_dt_spec *spec, const uint32_t reg_addr,
                   uint32_t *value);
int cs40l50_update_reg_dt(const struct i2c_dt_spec *spec, const uint32_t reg_addr,
                 const uint32_t mask, const uint32_t value);
int cs40l50_write_array_dt(const struct i2c_dt_spec *spec, const uint32_t *array, uint32_t words);
int cs40l50_poll_reg_dt(const struct i2c_dt_spec *spec, const uint32_t reg_addr,
                   uint32_t value, uint32_t tries, uint32_t delay);
int cs40l50_write_acked_reg_dt(const struct i2c_dt_spec *spec, const uint32_t reg_addr,
                                uint32_t val, uint32_t acked_val,  uint8_t tries,  uint32_t delay);

#endif
```

## src/cs40l50_fw_img.c
```c
/**
 * @file cs40l50_fw_img.c
 *
 * @brief CS40L50 FW IMG Source File
 *
 * @copyright
 * Copyright (c) Cirrus Logic 2024 All Rights Reserved, http://www.cirrus.com/
 *
 * Licensed under the Apache License, Version 2.0 (the License); you may
 * not use this file except in compliance with the License.
 * You may obtain a copy of the License at
 *
 * www.apache.org/licenses/LICENSE-2.0
 *
 * Unless required by applicable law or agreed to in writing, software
 * distributed under the License is distributed on an AS IS BASIS, WITHOUT
 * WARRANTIES OR CONDITIONS OF ANY KIND, either express or implied.
 * See the License for the specific language governing permissions and
 * limitations under the License.
 *
 * firmware_converter.py SDK version: 4.21.0 - internal
 * Command:  ../../tools/firmware_converter/firmware_converter.py fw_img_v2 cs40l50 ROM --wmdr cs40l50_wt.bin
 *
 */

/***********************************************************************************************************************
 * INCLUDES
 **********************************************************************************************************************/
#include "cs40l50_fw_img.h"

/***********************************************************************************************************************
 * FW_IMG
 **********************************************************************************************************************/

/**
 * @defgroup CS40L50_FW_IMG
 * @brief Firmware image
 *
 * @{
 */

const uint8_t cs40l50_fw_img[] = {
// Header
0xFF,0x98,0xB9,0x54, // IMG_MAGIC_NUMBER_1
0x02,0x00,0x00,0x00, // IMG_FORMAT_REV
0x04,0x03,0x00,0x00, // IMG_SIZE
0x00,0x00,0x00,0x00, // SYM_TABLE_SIZE
0x00,0x00,0x00,0x00, // ALG_LIST_SIZE
0x00,0x00,0x00,0x00, // FW_ID
0x45,0x23,0x01,0x00, // FW_VERSION
0x06,0x00,0x00,0x00, // DATA_BLOCKS
0x2C,0x10,0x00,0x00, // MAX_BLOCK_SIZE
0x00,0x00,0x00,0x00, // FW_IMG_VERSION
// Symbol Linking Table
// Algorithm ID List
// Firmware Data

// COEFF_DATA_BLOCKS_0
0x08,0x00,0x00,0x00, // COEFF_BLOCK_SIZE_0_0
0xE4,0x21,0x80,0x02, // COEFF_BLOCK_ADDR_0_0
0x00,0x00,0x00,0x01,0x00,0x00,0x00,0x01,
0x0C,0x00,0x00,0x00, // COEFF_BLOCK_SIZE_0_1
0xF8,0x21,0x80,0x02, // COEFF_BLOCK_ADDR_0_1
0x00,0x78,0x82,0x6C,0x00,0x78,0x82,0x6C,0x00,0x00,0x00,0x00,
0x14,0x00,0x00,0x00, // COEFF_BLOCK_SIZE_0_2
0x08,0x22,0x80,0x02, // COEFF_BLOCK_ADDR_0_2
0x00,0xA3,0xD7,0x0A,0x00,0x02,0x3D,0x70,0x00,0x7F,0xFF,0xFF,0x00,0x0C,0x80,0x00,0x00,0x00,0x00,0x00,
0x40,0x02,0x00,0x00, // COEFF_BLOCK_SIZE_0_3
0x20,0x22,0x80,0x02, // COEFF_BLOCK_ADDR_0_3
0x00,0x00,0x00,0x00,0x00,0x4B,0x00,0x00,0x00,0x00,0x00,0x97,0x00,0x00,0x01,0x2E,0x00,0x00,0x00,0x97,0x00,0xF5,0xAD,0x5C,
0x00,0x19,0x98,0x74,0x00,0x10,0x00,0x00,0x00,0x10,0x00,0x00,0x00,0x20,0x00,0x00,0x00,0x10,0x00,0x00,0x00,0xF2,0x9F,0xD2,
0x00,0x1C,0x90,0x66,0x00,0x10,0x00,0x00,0x00,0x7F,0xEC,0x58,0x00,0x78,0x82,0x6C,0x00,0x00,0x00,0x00,0x00,0x7D,0xB6,0x95,
0x00,0x00,0x00,0x00,0x00,0x78,0x82,0x6C,0x00,0x7F,0x3B,0xE2,0x00,0x00,0x00,0x00,0x00,0x08,0x00,0x00,0x00,0x08,0x00,0x00,
0x00,0x00,0x00,0x00,0x00,0x7F,0xFE,0x09,0x00,0x59,0x99,0x9A,0x00,0x7F,0xFF,0xFF,0x00,0x00,0x00,0x01,0x00,0x18,0x00,0x00,
0x00,0x08,0x00,0x00,0x00,0xBE,0xDE,0xAD,0x00,0x00,0x00,0x01,0x00,0x4B,0x00,0x00,0x00,0x08,0x95,0xDE,0x00,0xEE,0xD4,0x44,
0x00,0x08,0x95,0xDE,0x00,0xF9,0x74,0xAE,0x00,0x14,0x16,0x49,0x00,0x10,0x00,0x00,0x00,0x10,0x00,0x00,0x00,0xE0,0x00,0x00,
0x00,0x10,0x00,0x00,0x00,0xF4,0xBC,0x92,0x00,0x18,0x4A,0xB8,0x00,0x10,0x00,0x00,0x00,0x7F,0xEC,0x58,0x00,0x78,0x82,0x6C,
0x00,0x00,0x00,0x00,0x00,0x78,0x82,0x6C,0x00,0x00,0x00,0x00,0x00,0x78,0x82,0x6C,0x00,0x7C,0x35,0x2B,0x00,0x7F,0x3B,0xE2,
0x00,0x18,0x00,0x00,0x00,0x08,0x00,0x00,0x00,0x00,0x00,0x00,0x00,0x7F,0xFE,0x09,0x00,0x40,0x00,0x00,0x00,0x7F,0xFF,0xFF,
0x00,0x00,0x00,0x01,0x00,0x20,0x00,0x00,0x00,0x07,0x33,0x33,0x00,0xBE,0xDE,0xAD,0x00,0x01,0x47,0xAE,0x00,0x7F,0xFF,0xFF,
0x00,0x7F,0x4F,0x73,0x00,0x7F,0xFF,0x37,0x00,0x00,0x00,0x00,0x00,0x5E,0x17,0x7E,0x00,0x7F,0xFF,0xFF,0x00,0x7F,0xC5,0x10,
0x00,0x7F,0xFE,0x09,0x00,0x7C,0x35,0x2B,0x00,0x7F,0x9D,0xD2,0x00,0x40,0x00,0x00,0x00,0xFE,0xB8,0x52,0x00,0x0C,0xCC,0xCD,
0x00,0x7F,0xC5,0x10,0x00,0x7F,0xC5,0x10,0x00,0x7F,0xC5,0x10,0x00,0x7F,0xFE,0x09,0x00,0x7F,0xC5,0x10,0x00,0x7F,0xC5,0x10,
0x00,0x01,0x38,0x02,0x00,0xFF,0xDA,0xCB,0x00,0x01,0x38,0x02,0x00,0xF3,0x73,0x6C,0x00,0x17,0x9D,0x59,0x00,0x00,0x20,0x00,
0x00,0x01,0x63,0x71,0x00,0x01,0xD9,0xC3,0x00,0x01,0x63,0x71,0x00,0xF7,0xFB,0x2D,0x00,0x15,0xD8,0x26,0x00,0x7F,0xFF,0xFF,
0x00,0x80,0x00,0x0B,0x00,0x00,0x00,0x00,0x00,0x10,0x00,0x00,0x00,0x00,0x5A,0xBD,0x00,0x10,0x00,0x00,0x00,0xF4,0x37,0xD6,
0x00,0x15,0xDB,0x89,0x00,0x17,0x97,0x4C,0x00,0x10,0x00,0x00,0x00,0xE0,0x10,0xBA,0x00,0x10,0x00,0x00,0x00,0xF1,0x65,0x79,
0x00,0x1E,0x12,0x8E,0x00,0x17,0x97,0x4C,0x00,0x10,0x00,0x00,0x00,0xF3,0x4F,0x85,0x00,0x10,0x00,0x00,0x00,0xF2,0x26,0x13,
0x00,0x13,0xAD,0x95,0x00,0x54,0x46,0x38,0x00,0x10,0x00,0x00,0x00,0xE0,0x27,0x84,0x00,0x10,0x00,0x00,0x00,0xF0,0x6D,0xCC,
0x00,0x1F,0x40,0x67,0x00,0x54,0x46,0x38,0x00,0x10,0x00,0x00,0x00,0xF0,0x48,0x5A,0x00,0x10,0x00,0x00,0x00,0xF0,0x97,0x60,
0x00,0x13,0x0A,0x67,0x00,0x6A,0xC6,0xA8,0x00,0x10,0x00,0x00,0x00,0xE0,0x32,0x02,0x00,0x10,0x00,0x00,0x00,0xF0,0x19,0x22,
0x00,0x1F,0xA1,0x8E,0x00,0x6A,0xC6,0xA8,0x00,0xF0,0x00,0x00,0x00,0x00,0x00,0x00,0x00,0x10,0x00,0x00,0x00,0xF3,0xF0,0x72,
0x00,0x1A,0x4D,0xB7,0x00,0x33,0x56,0x6C,0x00,0x80,0x00,0x01,0x00,0x00,0x00,0x00,0x00,0x7F,0xFF,0xFF,0x00,0x00,0x00,0x00,
0x18,0x00,0x00,0x00, // COEFF_BLOCK_SIZE_0_4
0x40,0x07,0x40,0x03, // COEFF_BLOCK_ADDR_0_4
0x00,0x00,0x00,0x00,0x00,0x00,0x00,0x00,0x00,0x00,0x00,0x00,0x00,0x00,0x00,0x00,0x00,0x00,0x00,0x00,0x00,0x00,0x00,0x00,
0x24,0x00,0x00,0x00, // COEFF_BLOCK_SIZE_0_5
0x88,0x07,0x40,0x03, // COEFF_BLOCK_ADDR_0_5
0x00,0x00,0x00,0x00,0x00,0x00,0x00,0x00,0x00,0x00,0x00,0x00,0x00,0x00,0x00,0x00,0x00,0x00,0x00,0x00,0x00,0x00,0x00,0x00,
0x00,0x00,0x00,0x00,0x00,0x00,0x00,0x00,0x00,0x00,0x00,0x00,

// Footer
0xA6,0xE2,0x6B,0x93, // IMG_MAGIC_NUMBER_2
0x90,0xCD,0xF9,0x7F, // IMG_CHECKSUM
};

/** @} */

/**********************************************************************************************************************/
```

## src/cs40l50_fw_img.h
```c
/**
 * @file cs40l50_fw_img.h
 *
 * @brief CS40L50 FW IMG Header File
 *
 * @copyright
 * Copyright (c) Cirrus Logic 2024 All Rights Reserved, http://www.cirrus.com/
 *
 * Licensed under the Apache License, Version 2.0 (the License); you may
 * not use this file except in compliance with the License.
 * You may obtain a copy of the License at
 *
 * www.apache.org/licenses/LICENSE-2.0
 *
 * Unless required by applicable law or agreed to in writing, software
 * distributed under the License is distributed on an AS IS BASIS, WITHOUT
 * WARRANTIES OR CONDITIONS OF ANY KIND, either express or implied.
 * See the License for the specific language governing permissions and
 * limitations under the License.
 *
 */

#ifndef CS40L50_FW_IMG_H
#define CS40L50_FW_IMG_H

/***********************************************************************************************************************
 * INCLUDES
 **********************************************************************************************************************/
#include <stdint.h>

/***********************************************************************************************************************
 * FW_IMG
 **********************************************************************************************************************/

extern const uint8_t cs40l50_fw_img[];

/**********************************************************************************************************************/

#endif // CS40L50_FW_IMG_H
```

## src/cs40l50_syscfg_regs.c
```c
/**
 * @file cs40l50_syscfg_regs.c
 *
 * @brief Register values to be applied after CS40L50 Driver boot().
 *
 * @copyright
 * Copyright (c) Cirrus Logic 2024-2025 All Rights Reserved, http://www.cirrus.com/
 *
 * Licensed under the Apache License, Version 2.0 (the License); you may
 * not use this file except in compliance with the License.
 * You may obtain a copy of the License at
 *
 * www.apache.org/licenses/LICENSE-2.0
 *
 * Unless required by applicable law or agreed to in writing, software
 * distributed under the License is distributed on an AS IS BASIS, WITHOUT
 * WARRANTIES OR CONDITIONS OF ANY KIND, either express or implied.
 * See the License for the specific language governing permissions and
 * limitations under the License.
 *
 */
/***********************************************************************************************************************
 * INCLUDES
 **********************************************************************************************************************/
#include "cs40l50_syscfg_regs.h"
#include "cs40l50_spec.h"

/***********************************************************************************************************************
 * GLOBAL VARIABLES
 **********************************************************************************************************************/

/**
 * Application-specific config
 * Converted from cs40l50/config/wisce_init.txt
 * Please consult Cirrus for config appropriate to your application
 */
uint32_t cs40l50_syscfg_regs[] =
{
    0x0040, 0x0055,
    0x0040, 0x00aa,
    0x3808, 0x40000001,
    0x38ec, 0x0032,
    0x0040, 0x0000,
    0x201c, 0x0010,
    0x3800, 0x026e,
    0x2034, 0x2000000,
    0x280279c, 0x0006,
    0x280285c, 0x0000,
    0x280404c, 0x50020,
    0x2804050, 0x340200,
    0x2804054, 0x40020,
    0x2804058, 0x183201,
    0x280405c, 0x50044,
    0x2804060, 0x40100,
    0x2804064, 0xffffff
};
```

## src/cs40l50_syscfg_regs.h
```c
/**
 * @file cs40l50_syscfg_regs.h
 *
 * @brief Register values to be applied after CS40L50 Driver boot().
 *
 * @copyright
 * Copyright (c) Cirrus Logic 2024-2025 All Rights Reserved, http://www.cirrus.com/
 *
 * Licensed under the Apache License, Version 2.0 (the License); you may
 * not use this file except in compliance with the License.
 * You may obtain a copy of the License at
 *
 * www.apache.org/licenses/LICENSE-2.0
 *
 * Unless required by applicable law or agreed to in writing, software
 * distributed under the License is distributed on an AS IS BASIS, WITHOUT
 * WARRANTIES OR CONDITIONS OF ANY KIND, either express or implied.
 * See the License for the specific language governing permissions and
 * limitations under the License.
 *
 * wisce_to_syscfg_reg_converter.py SDK version: 4.21.0 - internal
 * Command:  ../../tools/wisce_script_converter/wisce_script_converter.py -c c_array -p cs40l50 -i /Users/drhodes/Documents/code/cross-compile/nfs-share/altos/driver/cs40l50/config/wisce_init.txt -o .
 *
 */

#ifndef CS40L50_SYSCFG_REGS_H
#define CS40L50_SYSCFG_REGS_H

#ifdef __cplusplus
extern "C" {
#endif

/***********************************************************************************************************************
 * INCLUDES
 **********************************************************************************************************************/
#include "stdint.h"
//#include "regmap.h"

/***********************************************************************************************************************
 * LITERALS & CONSTANTS
 **********************************************************************************************************************/
#define CS40L50_SYSCFG_REGS_TOTAL (34)

/***********************************************************************************************************************
 * ENUMS, STRUCTS, UNIONS, TYPEDEFS
 **********************************************************************************************************************/

/***********************************************************************************************************************
 * GLOBAL VARIABLES
 **********************************************************************************************************************/
extern uint32_t cs40l50_syscfg_regs[];

#ifdef __cplusplus
}
#endif

#endif // CS40L50_SYSCFG_REGS_H
```
